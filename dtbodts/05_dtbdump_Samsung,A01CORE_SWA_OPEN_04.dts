/dts-v1/;

/ {
	compatible = "Samsung,A01CORE SWA OPEN 04", "Mediatek,MT6739";
	dtbo-hw_rev = <0x4>;
	dtbo-hw_rev_end = <0xff>;

	__fixups__ {
		accdet = "/fragment@5:target:0", "/fragment@34:target:0", "/fragment@58:target:0";
		als = "/fragment@33:target:0";
		apuart0 = "/fragment@13:target:0";
		apuart1 = "/fragment@14:target:0";
		audgpio = "/fragment@18:target:0";
		auxadc = "/fragment@21:target:0";
		chosen = "/fragment@0:target:0";
		consys = "/fragment@9:target:0";
		eint = "/fragment@model/__overlay__/i2c@23/lis2ds@1D:interrupt-parent:0";
		gpio = "/fragment@30:target:0", "/fragment@48:target:0";
		gpio_usage_mapping = "/fragment@29:target:0";
		i2c0 = "/fragment@23:target:0";
		i2c1 = "/fragment@2:target:0", "/fragment@24:target:0", "/fragment@54:target:0";
		i2c2 = "/fragment@10:target:0", "/fragment@25:target:0", "/fragment@56:target:0";
		i2c3 = "/fragment@26:target:0", "/fragment@51:target:0";
		i2c4 = "/fragment@27:target:0", "/fragment@57:target:0";
		i2c5 = "/fragment@28:target:0", "/fragment@52:target:0";
		irq_nfc = "/fragment@17:target:0";
		irtx_pwm = "/fragment@11:target:0";
		kd_camera_hw1 = "/fragment@45:target:0", "/fragment@50:target:0";
		keypad = "/fragment@47:target:0";
		main_pmic = "/fragment@36:target:0";
		md1_sim1_hot_plug_eint = "/fragment@37:target:0";
		md1_sim2_hot_plug_eint = "/fragment@38:target:0";
		mrdump_ext_rst = "/fragment@32:target:0";
		msdc1 = "/fragment@7:target:0", "/fragment@63:target:0";
		msdc1_ins = "/fragment@35:target:0";
		mt_pmic_vcama_ldo_reg = "/fragment@39:target:0", "/fragment@45/__overlay__:vcama-supply:0", "/fragment@45/__overlay__:vcama_sub-supply:0", "/fragment@50/__overlay__:cam1_vcama-supply:0";
		mt_pmic_vcamd_ldo_reg = "/fragment@42:target:0", "/fragment@45/__overlay__:vcamd-supply:0", "/fragment@45/__overlay__:vcamd_sub-supply:0", "/fragment@50/__overlay__:cam1_vcamd-supply:0";
		mt_pmic_vcamio_ldo_reg = "/fragment@43:target:0", "/fragment@45/__overlay__:vcamio-supply:0", "/fragment@45/__overlay__:vcamio_sub-supply:0", "/fragment@50/__overlay__:cam0_vcamio-supply:0", "/fragment@50/__overlay__:cam1_vcamio-supply:0";
		mt_pmic_vldo28_ldo_reg = "/fragment@44:target:0", "/fragment@45/__overlay__:vcamaf-supply:0", "/fragment@46/__overlay__:vtouch-supply:0", "/fragment@50/__overlay__:cam0_vcamaf-supply:0";
		mt_pmic_vsim1_ldo_reg = "/fragment@40:target:0";
		mt_pmic_vsim2_ldo_reg = "/fragment@41:target:0";
		mtkfb = "/fragment@4:target:0";
		nfc = "/fragment@16:target:0";
		odm = "/fragment@1:target:0";
		pio = "/fragment@3:target:0", "/fragment@5/__overlay__:interrupt-parent:0", "/fragment@5/__overlay__:deb-gpios:0", "/fragment@6:target:0", "/fragment@7/__overlay__:cd-gpios:0", "/fragment@8:target:0", "/fragment@10/__overlay__/s2mu005@3D/s2mu005_fled:s2mu005,flash-gpio:0", "/fragment@10/__overlay__/s2mu005@3D/s2mu005_fled:s2mu005,torch-gpio:0", "/fragment@12:target:0", "/fragment@15:target:0", "/fragment@16/__overlay__:gpio-rst-std:0", "/fragment@16/__overlay__:gpio-irq-std:0", "/fragment@19:target:0", "/fragment@29/__overlay__:GPIO_SIM1_HOT_PLUG:0", "/fragment@29/__overlay__:GPIO_SIM1_SCLK:0", "/fragment@29/__overlay__:GPIO_SIM1_SRST:0", "/fragment@29/__overlay__:GPIO_SIM1_SIO:0", "/fragment@29/__overlay__:GPIO_SIM2_SCLK:0", "/fragment@29/__overlay__:GPIO_SIM2_SRST:0", "/fragment@29/__overlay__:GPIO_SIM2_SIO:0", "/fragment@29/__overlay__:GPIO_FDD_BAND_SUPPORT_DETECT_2ND_PIN:0", "/fragment@29/__overlay__:GPIO_FDD_BAND_SUPPORT_DETECT_1ST_PIN:0", "/fragment@29/__overlay__:GPIO_FDD_BAND_SUPPORT_DETECT_4TH_PIN:0", "/fragment@29/__overlay__:GPIO_FDD_BAND_SUPPORT_DETECT_3RD_PIN:0", "/fragment@31/__overlay__:interrupt-parent:0", "/fragment@32/__overlay__:interrupt-parent:0", "/fragment@33/__overlay__:interrupt-parent:0", "/fragment@34/__overlay__:interrupt-parent:0", "/fragment@35/__overlay__:interrupt-parent:0", "/fragment@36/__overlay__:interrupt-parent:0", "/fragment@49:target:0", "/fragment@53:target:0", "/fragment@54/__overlay__/s2mu005-fuelgauge@3b:fuelgauge,fuel_int:0", "/fragment@model/__overlay__/i2c@23:gpios:0", "/fragment@model/__overlay__/i2c@23:gpios:12", "/fragment@model/__overlay__/i2c@23/lis2ds@1D:st,irq_gpio:0", "/fragment@model/__overlay__/i2c@23/lis2ds@1D:st,vdd_ldo_pin:0", "/fragment@55:target:0", "/fragment@56/__overlay__/s2mu005@3D:s2mu005,irq-gpio:0", "/fragment@57/__overlay__/speaker_amp@34:reset-gpio:0", "/fragment@59:target:0", "/fragment@60:target:0", "/fragment@61/__overlay__/synaptics_tcm@0:interrupt-parent:0", "/fragment@61/__overlay__/synaptics_tcm@0:synaptics,irq-gpio:0", "/fragment@61/__overlay__/novatek@1:novatek,irq-gpio:0", "/fragment@62:target:0", "/fragment@lcd/__overlay__/smcdsd_board_nt36525b:gpio_lcd_rst:0", "/fragment@lcd/__overlay__/smcdsd_board_nt36525b:gpio_lcd_en_1p8:0", "/fragment@lcd/__overlay__/smcdsd_board_nt36525b:gpio_lcd_blen:0", "/fragment@lcd/__overlay__/smcdsd_board_nt36525b:gpio_con:0", "/fragment@lcd/__overlay__/smcdsd_board_td4150:gpio_lcd_rst:0", "/fragment@lcd/__overlay__/smcdsd_board_td4150:gpio_lcd_en_1p8:0", "/fragment@lcd/__overlay__/smcdsd_board_td4150:gpio_lcd_blen:0", "/fragment@lcd/__overlay__/smcdsd_board_td4150:gpio_con:0", "/fragment@63/__overlay__:cd-gpios:0";
		pmic_clock_buffer_ctrl = "/fragment@22:target:0";
		soc_codec = "/fragment@20:target:0";
		spi0 = "/fragment@61:target:0";
		touch = "/fragment@31:target:0", "/fragment@46:target:0";
	};

	__local_fixups__ {

		fragment@11 {

			__overlay__ {
				pinctrl-0 = <0x0>;
				pinctrl-1 = <0x0>;
			};
		};

		fragment@13 {

			__overlay__ {
				pinctrl-0 = <0x0>;
				pinctrl-1 = <0x0>;
				pinctrl-2 = <0x0>;
				pinctrl-3 = <0x0>;
				pinctrl-4 = <0x0>;
			};
		};

		fragment@14 {

			__overlay__ {
				pinctrl-0 = <0x0>;
			};
		};

		fragment@18 {

			__overlay__ {
				pinctrl-0 = <0x0>;
				pinctrl-1 = <0x0>;
				pinctrl-2 = <0x0>;
				pinctrl-3 = <0x0>;
				pinctrl-4 = <0x0>;
				pinctrl-5 = <0x0>;
				pinctrl-6 = <0x0>;
				pinctrl-7 = <0x0>;
				pinctrl-8 = <0x0>;
				pinctrl-9 = <0x0>;
			};
		};

		fragment@4 {

			__overlay__ {
				pinctrl-0 = <0x0>;
				pinctrl-1 = <0x0>;
				pinctrl-2 = <0x0>;
				pinctrl-3 = <0x0>;
				pinctrl-4 = <0x0>;
				pinctrl-5 = <0x0>;
			};
		};

		fragment@5 {

			__overlay__ {
				pinctrl-0 = <0x0>;
				pinctrl-1 = <0x0>;
			};
		};

		fragment@50 {

			__overlay__ {
				pinctrl-0 = <0x0>;
				pinctrl-1 = <0x0>;
				pinctrl-10 = <0x0>;
				pinctrl-11 = <0x0>;
				pinctrl-12 = <0x0>;
				pinctrl-2 = <0x0>;
				pinctrl-3 = <0x0>;
				pinctrl-4 = <0x0>;
				pinctrl-5 = <0x0>;
				pinctrl-6 = <0x0>;
				pinctrl-7 = <0x0>;
				pinctrl-8 = <0x0>;
				pinctrl-9 = <0x0>;
			};
		};

		fragment@54 {

			__overlay__ {

				s2mu005-fuelgauge@3b {
					pinctrl-0 = <0x0>;
				};
			};
		};

		fragment@56 {

			__overlay__ {

				s2mu005@3D {
					pinctrl-0 = <0x0>;
				};
			};
		};

		fragment@61 {

			__overlay__ {

				novatek@1 {
					pinctrl-0 = <0x0 0x4 0x8 0xc 0x10>;
					pinctrl-1 = <0x0 0x4 0x8 0xc 0x10>;
				};

				synaptics_tcm@0 {
					pinctrl-0 = <0x0 0x4 0x8 0xc 0x10>;
					pinctrl-1 = <0x0 0x4 0x8 0xc 0x10>;
				};
			};
		};

		fragment@9 {

			__overlay__ {
				pinctrl-0 = <0x0>;
				pinctrl-1 = <0x0>;
				pinctrl-2 = <0x0>;
				pinctrl-3 = <0x0>;
			};
		};

		fragment@lcd {

			__overlay__ {

				nt36525b {
					smcdsd_board = <0x0>;
				};

				panel {
					smcdsd_panel = <0x0 0x4>;
				};

				smcdsd_board_nt36525b {
					pinctrl-0 = <0x0>;
					pinctrl-1 = <0x0>;
				};

				smcdsd_board_td4150 {
					pinctrl-0 = <0x0>;
					pinctrl-1 = <0x0>;
				};

				td4150 {
					smcdsd_board = <0x0>;
				};
			};
		};

		fragment@model {

			__overlay__ {

				i2c@23 {
					pinctrl-0 = <0x0 0x4>;

					lis2ds@1D {
						pinctrl-0 = <0x0>;
					};
				};
			};
		};
	};

	__symbols__ {
		acc_int = "/fragment@59/__overlay__/acc_int";
		accdet_pins_default = "/fragment@6/__overlay__/accdetdefault";
		accdet_pins_eint_as_int = "/fragment@6/__overlay__/accdeteint@0";
		aud_clk_miso_off = "/fragment@19/__overlay__/aud_clk_miso_off";
		aud_clk_miso_on = "/fragment@19/__overlay__/aud_clk_miso_on";
		aud_clk_mosi_off = "/fragment@19/__overlay__/aud_clk_mosi_off";
		aud_clk_mosi_on = "/fragment@19/__overlay__/aud_clk_mosi_on";
		aud_dat_miso_off = "/fragment@19/__overlay__/aud_dat_miso_off";
		aud_dat_miso_on = "/fragment@19/__overlay__/aud_dat_miso_on";
		aud_dat_mosi_off = "/fragment@19/__overlay__/aud_dat_mosi_off";
		aud_dat_mosi_on = "/fragment@19/__overlay__/aud_dat_mosi_on";
		aud_pins_smartpa_off = "/fragment@19/__overlay__/aud_pins_smartpa_off";
		aud_pins_smartpa_on = "/fragment@19/__overlay__/aud_pins_smartpa_on";
		camera0_mclk_off = "/fragment@49/__overlay__/camera0_mclk_gpio_mode@gpio126";
		camera0_mclk_on = "/fragment@49/__overlay__/camera0_mclk_on@gpio126";
		camera0_rst_high = "/fragment@49/__overlay__/camera0_rst_output_high@gpio27";
		camera0_rst_low = "/fragment@49/__overlay__/camera0_rst_output_low@gpio27";
		camera0_vcama_ldo_en_off = "/fragment@49/__overlay__/camera0_vcama_output_low@gpio25";
		camera0_vcama_ldo_en_on = "/fragment@49/__overlay__/camera0_vcama_output_high@gpio25";
		camera0_vcamd_ldo_en_off = "/fragment@49/__overlay__/camera0_vcamd_output_low@gpio136";
		camera0_vcamd_ldo_en_on = "/fragment@49/__overlay__/camera0_vcamd_output_high@gpio136";
		camera1_mclk_off = "/fragment@49/__overlay__/camera1_mclk_gpio_mode@gpio127";
		camera1_mclk_on = "/fragment@49/__overlay__/camera1_mclk_on@gpio127";
		camera1_rst_high = "/fragment@49/__overlay__/camera1_rst_output_high@gpio22";
		camera1_rst_low = "/fragment@49/__overlay__/camera1_rst_output_low@gpio22";
		camera_main_af_mtk = "/fragment@52/__overlay__/camera_main_af@0c";
		camera_main_eeprom_mtk = "/fragment@52/__overlay__/camera_main_eeprom@58";
		camera_main_mtk = "/fragment@51/__overlay__/camera_main@10";
		camera_pins_default = "/fragment@49/__overlay__/camdefault";
		camera_sub_eeprom_mtk = "/fragment@52/__overlay__/camera_sub_eeprom@38";
		camera_sub_mtk = "/fragment@52/__overlay__/camera_sub@37";
		consys_pins_default = "/fragment@8/__overlay__/consys_default";
		fg_alert_default = "/fragment@53/__overlay__/fg_alert_default";
		fuelgauge_mtk = "/fragment@24/__overlay__/fuelgauge@76";
		gpslna_pins_init = "/fragment@8/__overlay__/gpslna@0";
		gpslna_pins_oh = "/fragment@8/__overlay__/gpslna@1";
		gpslna_pins_ol = "/fragment@8/__overlay__/gpslna@2";
		i2c23 = "/fragment@model/__overlay__/i2c@23";
		i2c_lcd_bias_mtk = "/fragment@23/__overlay__/i2c_lcd_bias@11";
		if_pmic_irq = "/fragment@55/__overlay__/if_pmic_irq";
		irtx_gpio_led_default = "/fragment@12/__overlay__/irtx_gpio_led_def@gpio12";
		irtx_gpio_led_set = "/fragment@12/__overlay__/irtx_gpio_led_set@gpio12";
		lcd_bc_ctrl_init = "/fragment@62/__overlay__/lcd_bc_ctrl_init";
		lcd_bc_ctrl_sleep = "/fragment@62/__overlay__/lcd_bc_ctrl_sleep";
		led0 = "/fragment@1/__overlay__/led@0";
		led1 = "/fragment@1/__overlay__/led@1";
		led2 = "/fragment@1/__overlay__/led@2";
		led3 = "/fragment@1/__overlay__/led@3";
		led4 = "/fragment@1/__overlay__/led@4";
		led5 = "/fragment@1/__overlay__/led@5";
		mtkfb_pins_lcd_bias_enp0 = "/fragment@3/__overlay__/lcd_bias_enp0_gpio";
		mtkfb_pins_lcd_bias_enp1 = "/fragment@3/__overlay__/lcd_bias_enp1_gpio";
		mtkfb_pins_lcm_reset0 = "/fragment@3/__overlay__/lcm_rst_out0_gpio";
		mtkfb_pins_lcm_reset1 = "/fragment@3/__overlay__/lcm_rst_out1_gpio";
		mtkfb_pins_mode_te_gpio = "/fragment@3/__overlay__/mode_te_gpio";
		mtkfb_pins_mode_te_te = "/fragment@3/__overlay__/mode_te_te";
		nt36525b = "/fragment@lcd/__overlay__/nt36525b";
		sensor_i2c = "/fragment@59/__overlay__/sensor_i2c";
		sensor_ldo_1p8_en = "/fragment@59/__overlay__/sensor_ldo_1p8_en";
		smcdsd_board_nt36525b = "/fragment@lcd/__overlay__/smcdsd_board_nt36525b";
		smcdsd_board_td4150 = "/fragment@lcd/__overlay__/smcdsd_board_td4150";
		spi_clk_init = "/fragment@60/__overlay__/spi_clk_init";
		spi_clk_sleep = "/fragment@60/__overlay__/spi_clk_sleep";
		spi_cs_init = "/fragment@60/__overlay__/spi_cs_init";
		spi_cs_sleep = "/fragment@60/__overlay__/spi_cs_sleep";
		spi_miso_init = "/fragment@60/__overlay__/spi_miso_init";
		spi_miso_sleep = "/fragment@60/__overlay__/spi_miso_sleep";
		spi_mosi_init = "/fragment@60/__overlay__/spi_mosi_init";
		spi_mosi_sleep = "/fragment@60/__overlay__/spi_mosi_sleep";
		subpmic_mtk = "/fragment@25/__overlay__/subpmic@6a";
		td4150 = "/fragment@lcd/__overlay__/td4150";
		ts_pin_init = "/fragment@60/__overlay__/ts_pin_init";
		ts_pin_sleep = "/fragment@60/__overlay__/ts_pin_sleep";
		uart0_gpio_def_cfg = "/fragment@15/__overlay__/uart0gpiodefault";
		uart0_rx_clr_cfg = "/fragment@15/__overlay__/uart0_rx_clear@gpio20";
		uart0_rx_set_cfg = "/fragment@15/__overlay__/uart0_rx_set@gpio20";
		uart0_tx_clr_cfg = "/fragment@15/__overlay__/uart0_tx_clear@gpio21";
		uart0_tx_set_cfg = "/fragment@15/__overlay__/uart0_tx_set@gpio21";
		uart1_gpio_def_cfg = "/fragment@15/__overlay__/uart1gpiodefault";
		vibrator0 = "/fragment@1/__overlay__/vibrator@0";
	};

	fragment@0 {
		target = <0xffffffff>;

		__overlay__ {
			atag,videolfb-fb_base_h = <0x0>;
			atag,videolfb-fb_base_l = "^`P";
			atag,videolfb-fps = <0x1770>;
			atag,videolfb-islcm_inited = <0x0>;
			atag,videolfb-islcmfound = <0x1>;
			atag,videolfb-lcmname = "td4150_hdp_dis_vdo_a01core_lcm_drv";
			atag,videolfb-vramSize = <0x17bb000>;
		};
	};

	fragment@1 {
		target = <0xffffffff>;

		__overlay__ {

			led@0 {
				compatible = "mediatek,red";
				data = <0x1>;
				led_mode = <0x0>;
				phandle = <0x41>;
				pwm_config = <0x0 0x0 0x0 0x0 0x0>;
			};

			led@1 {
				compatible = "mediatek,green";
				data = <0x1>;
				led_mode = <0x0>;
				phandle = <0x42>;
				pwm_config = <0x0 0x0 0x0 0x0 0x0>;
			};

			led@2 {
				compatible = "mediatek,blue";
				data = <0x1>;
				led_mode = <0x0>;
				phandle = <0x43>;
				pwm_config = <0x0 0x0 0x0 0x0 0x0>;
			};

			led@3 {
				compatible = "mediatek,jogball-backlight";
				data = <0x1>;
				led_mode = <0x0>;
				phandle = <0x44>;
				pwm_config = <0x0 0x0 0x0 0x0 0x0>;
			};

			led@4 {
				compatible = "mediatek,keyboard-backlight";
				data = <0x1>;
				led_mode = <0x0>;
				phandle = <0x45>;
				pwm_config = <0x0 0x0 0x0 0x0 0x0>;
			};

			led@5 {
				compatible = "mediatek,button-backlight";
				data = <0x1>;
				led_mode = <0x0>;
				phandle = <0x46>;
				pwm_config = <0x0 0x0 0x0 0x0 0x0>;
			};

			vibrator@0 {
				compatible = "mediatek,vibrator";
				phandle = <0x47>;
				vib_limit = <0x9>;
				vib_timer = <0x19>;
				vib_vol = <0x9>;
			};
		};
	};

	fragment@10 {
		target = <0xffffffff>;

		__overlay__ {

			s2mu005@3D {

				s2mu005_fled {
					compatible = "samsung,s2mu005-fled";
					default_current = <0x32>;
					default_timer = <0x0>;
					main_flash_current = <0x4b0>;
					movie_current = <0xc8>;
					rear_preflash_current = <0xc8>;
					s2mu005,flash-gpio = <0xffffffff 0x77 0x0>;
					s2mu005,torch-gpio = <0xffffffff 0x7a 0x0>;
					torch_current = <0x78>;

					S2MU005_FLASH_LED {
						brightness = <0x3e8>;
						id = <0x0>;
						ledname = "S2MU005_FLASH_LED";
						max_brightness = <0x4b0>;
						timeout = <0xf>;
					};

					S2MU005_TORCH_LED {
						brightness = <0x50>;
						id = <0x1>;
						ledname = "S2MU005_TORCH_LED";
						max_brightness = <0x190>;
						timeout = <0xf>;
					};
				};
			};
		};
	};

	fragment@11 {
		target = <0xffffffff>;

		__overlay__ {
			pinctrl-0 = <0xd>;
			pinctrl-1 = <0xe>;
			pinctrl-names = "irtx_gpio_led_default", "irtx_gpio_led_set";
			status = "okay";
		};
	};

	fragment@12 {
		target = <0xffffffff>;

		__overlay__ {

			irtx_gpio_led_def@gpio12 {
				phandle = <0xd>;

				pins_cmd_dat {
					bias-disable;
					input-schmitt-enable = <0x0>;
					output-low;
					pinmux = <0xc00>;
					slew-rate = <0x1>;
				};
			};

			irtx_gpio_led_set@gpio12 {
				phandle = <0xe>;

				pins_cmd_dat {
					output-high;
					pinmux = <0xc05>;
					slew-rate = <0x1>;
				};
			};
		};
	};

	fragment@13 {
		target = <0xffffffff>;

		__overlay__ {
			pinctrl-0 = <0xf>;
			pinctrl-1 = <0x10>;
			pinctrl-2 = <0x11>;
			pinctrl-3 = <0x12>;
			pinctrl-4 = <0x13>;
			pinctrl-names = "uart0_gpio_default", "uart0_rx_set", "uart0_rx_clear", "uart0_tx_set", "uart0_tx_clear";
			status = "okay";
		};
	};

	fragment@14 {
		target = <0xffffffff>;

		__overlay__ {
			pinctrl-0 = <0x14>;
			pinctrl-names = "uart1_gpio_default";
			status = "okay";
		};
	};

	fragment@15 {
		target = <0xffffffff>;

		__overlay__ {

			uart0_rx_clear@gpio20 {
				phandle = <0x11>;

				pins_cmd_dat {
					bias-pull-up;
					pinmux = <0x1401>;
				};
			};

			uart0_rx_set@gpio20 {
				phandle = <0x10>;

				pins_cmd_dat {
					pinmux = <0x1401>;
				};
			};

			uart0_tx_clear@gpio21 {
				phandle = <0x13>;

				pins_cmd_dat {
					output-high;
					pinmux = <0x1500>;
					slew-rate = <0x1>;
				};
			};

			uart0_tx_set@gpio21 {
				phandle = <0x12>;

				pins_cmd_dat {
					pinmux = <0x1501>;
				};
			};

			uart0gpiodefault {
				phandle = <0xf>;
			};

			uart1gpiodefault {
				phandle = <0x14>;
			};
		};
	};

	fragment@16 {
		target = <0xffffffff>;

		__overlay__ {
			compatible = "mediatek,nfc-gpio-v2";
			gpio-irq = <0xe>;
			gpio-irq-std = <0xffffffff 0xe 0x0>;
			gpio-rst = <0x7>;
			gpio-rst-std = <0xffffffff 0x7 0x0>;
		};
	};

	fragment@17 {
		target = <0xffffffff>;

		__overlay__ {
			compatible = "mediatek,irq_nfc-eint";
		};
	};

	fragment@18 {
		target = <0xffffffff>;

		__overlay__ {
			pinctrl-0 = <0x15>;
			pinctrl-1 = <0x16>;
			pinctrl-2 = <0x17>;
			pinctrl-3 = <0x18>;
			pinctrl-4 = <0x19>;
			pinctrl-5 = <0x1a>;
			pinctrl-6 = <0x1b>;
			pinctrl-7 = <0x1c>;
			pinctrl-8 = <0x1d>;
			pinctrl-9 = <0x1e>;
			pinctrl-names = "aud_clk_mosi_off", "aud_clk_mosi_on", "aud_clk_miso_off", "aud_clk_miso_on", "aud_dat_mosi_off", "aud_dat_mosi_on", "aud_dat_miso_off", "aud_dat_miso_on", "aud_smartpa_off", "aud_smartpa_on";
			status = "okay";
		};
	};

	fragment@19 {
		target = <0xffffffff>;

		__overlay__ {

			aud_clk_miso_off {
				phandle = <0x17>;

				pins_cmd0_dat {
					bias-pull-down;
					pinmux = <0x4500>;
				};

				pins_cmd1_dat {
					bias-pull-down;
					pinmux = <0x4200>;
				};
			};

			aud_clk_miso_on {
				phandle = <0x18>;

				pins_cmd0_dat {
					bias-disable;
					input-schmitt-enable;
					pinmux = <0x4501>;
				};

				pins_cmd1_dat {
					bias-disable;
					input-schmitt-enable;
					pinmux = <0x4201>;
				};
			};

			aud_clk_mosi_off {
				phandle = <0x15>;

				pins_cmd0_dat {
					bias-pull-down;
					input-enable;
					pinmux = <0x4100>;
					slew-rate = <0x0>;
				};

				pins_cmd1_dat {
					bias-pull-down;
					input-enable;
					pinmux = <0x3e00>;
					slew-rate = <0x0>;
				};
			};

			aud_clk_mosi_on {
				phandle = <0x16>;

				pins_cmd0_dat {
					bias-disable;
					input-schmitt-enable;
					pinmux = <0x4101>;
				};

				pins_cmd1_dat {
					bias-disable;
					input-schmitt-enable;
					pinmux = <0x3e01>;
				};
			};

			aud_dat_miso_off {
				phandle = <0x1b>;

				pins_cmd1_dat {
					bias-pull-down;
					input-enable;
					pinmux = <0x4300>;
					slew-rate = <0x0>;
				};

				pins_cmd2_dat {
					bias-pull-down;
					input-enable;
					pinmux = <0x4400>;
					slew-rate = <0x0>;
				};
			};

			aud_dat_miso_on {
				phandle = <0x1c>;

				pins_cmd1_dat {
					pinmux = <0x4301>;
				};

				pins_cmd2_dat {
					pinmux = <0x4401>;
				};
			};

			aud_dat_mosi_off {
				phandle = <0x19>;

				pins_cmd1_dat {
					bias-disable;
					input-enable;
					pinmux = <0x3f00>;
					slew-rate = <0x0>;
				};

				pins_cmd2_dat {
					bias-disable;
					input-enable;
					pinmux = <0x4000>;
					slew-rate = <0x0>;
				};
			};

			aud_dat_mosi_on {
				phandle = <0x1a>;

				pins_cmd1_dat {
					pinmux = <0x3f01>;
				};

				pins_cmd2_dat {
					pinmux = <0x4001>;
				};
			};

			aud_pins_smartpa_off {
				phandle = <0x1d>;

				pins_cmd0_dat {
					bias-pull-down;
					pinmux = <0x1801>;
				};

				pins_cmd1_dat {
					pinmux = <0x1104>;
				};

				pins_cmd2_dat {
					pinmux = <0x1304>;
				};

				pins_cmd3_dat {
					pinmux = <0x1204>;
				};
			};

			aud_pins_smartpa_on {
				phandle = <0x1e>;

				pins_cmd0_dat {
					pinmux = <0x1801>;
				};

				pins_cmd1_dat {
					pinmux = <0x1104>;
				};

				pins_cmd2_dat {
					pinmux = <0x1304>;
				};

				pins_cmd3_dat {
					pinmux = <0x1204>;
				};
			};
		};
	};

	fragment@2 {
		target = <0xffffffff>;

		__overlay__ {
			#address-cells = <0x1>;
			#size-cells = <0x0>;
			clock-frequency = <0x61a80>;
			mediatek,use-open-drain;
			status = "okay";
		};
	};

	fragment@20 {
		target = <0xffffffff>;

		__overlay__ {
			always_pull_down_enable = <0x0>;
			always_pull_low_off = <0x0>;
		};
	};

	fragment@21 {
		target = <0xffffffff>;

		__overlay__ {

			adc_channel@ {
				compatible = "mediatek,adc_channel";
				mediatek,adc_fdd_rf_params_dynamic_custom_ch = <0xc>;
				mediatek,temperature0 = <0x0>;
				mediatek,temperature1 = <0x1>;
				status = "okay";
			};
		};
	};

	fragment@22 {
		target = <0xffffffff>;

		__overlay__ {
			mediatek,clkbuf-config = <0x2 0x1 0x1 0x2 0x0 0x0 0x0>;
			mediatek,clkbuf-driving-current = <0xffffffff 0xffffffff 0xffffffff 0xffffffff 0xffffffff 0xffffffff 0xffffffff>;
			mediatek,clkbuf-quantity = <0x7>;
			status = "okay";
		};
	};

	fragment@23 {
		target = <0xffffffff>;

		__overlay__ {
			#address-cells = <0x1>;
			#size-cells = <0x0>;
			clock-frequency = <0x493e0>;
			mediatek,use-open-drain;

			i2c_lcd_bias@11 {
				compatible = "mediatek,i2c_lcd_bias";
				phandle = <0x48>;
				reg = <0x11>;
				status = "okay";
			};
		};
	};

	fragment@24 {
		target = <0xffffffff>;

		__overlay__ {
			#address-cells = <0x1>;
			#size-cells = <0x0>;
			clock-frequency = <0x61a80>;
			mediatek,use-open-drain;

			fuelgauge@76 {
				compatible = "mediatek,fuelgauge";
				phandle = <0x49>;
				reg = <0x76>;
				status = "okay";
			};
		};
	};

	fragment@25 {
		target = <0xffffffff>;

		__overlay__ {
			#address-cells = <0x1>;
			#size-cells = <0x0>;
			clock-frequency = <0x61a80>;
			mediatek,use-open-drain;

			subpmic@6a {
				compatible = "mediatek,subpmic";
				phandle = <0x4a>;
				reg = <0x6a>;
				status = "okay";
			};
		};
	};

	fragment@26 {
		target = <0xffffffff>;

		__overlay__ {
			#address-cells = <0x1>;
			#size-cells = <0x0>;
			clock-frequency = <0x61a80>;
			mediatek,use-open-drain;
		};
	};

	fragment@27 {
		target = <0xffffffff>;

		__overlay__ {
			#address-cells = <0x1>;
			#size-cells = <0x0>;
			clock-frequency = <0x61a80>;
			mediatek,use-open-drain;
		};
	};

	fragment@28 {
		target = <0xffffffff>;

		__overlay__ {
			#address-cells = <0x1>;
			#size-cells = <0x0>;
			clock-frequency = <0x61a80>;
			mediatek,use-open-drain;
		};
	};

	fragment@29 {
		target = <0xffffffff>;

		__overlay__ {
			GPIO_FDD_BAND_SUPPORT_DETECT_1ST_PIN = <0xffffffff 0x5b 0x0>;
			GPIO_FDD_BAND_SUPPORT_DETECT_2ND_PIN = <0xffffffff 0x5a 0x0>;
			GPIO_FDD_BAND_SUPPORT_DETECT_3RD_PIN = <0xffffffff 0x70 0x0>;
			GPIO_FDD_BAND_SUPPORT_DETECT_4TH_PIN = <0xffffffff 0x6c 0x0>;
			GPIO_SIM1_HOT_PLUG = <0xffffffff 0x23 0x0>;
			GPIO_SIM1_SCLK = <0xffffffff 0x4d 0x0>;
			GPIO_SIM1_SIO = <0xffffffff 0x4f 0x0>;
			GPIO_SIM1_SRST = <0xffffffff 0x4e 0x0>;
			GPIO_SIM2_SCLK = <0xffffffff 0x50 0x0>;
			GPIO_SIM2_SIO = <0xffffffff 0x52 0x0>;
			GPIO_SIM2_SRST = <0xffffffff 0x51 0x0>;
		};
	};

	fragment@3 {
		target = <0xffffffff>;

		__overlay__ {

			lcd_bias_enp0_gpio {
				phandle = <0x5>;

				pins_cmd_dat {
					output-low;
					pinmux = <0x1a00>;
					slew-rate = <0x1>;
				};
			};

			lcd_bias_enp1_gpio {
				phandle = <0x6>;

				pins_cmd_dat {
					output-high;
					pinmux = <0x1a00>;
					slew-rate = <0x1>;
				};
			};

			lcm_rst_out0_gpio {
				phandle = <0x3>;

				pins_cmd_dat {
					output-low;
					pinmux = <0x5301>;
					slew-rate = <0x1>;
				};
			};

			lcm_rst_out1_gpio {
				phandle = <0x4>;

				pins_cmd_dat {
					output-high;
					pinmux = <0x5301>;
					slew-rate = <0x1>;
				};
			};

			mode_te_gpio {
				phandle = <0x1>;
			};

			mode_te_te {
				phandle = <0x2>;
			};
		};
	};

	fragment@30 {
		target = <0xffffffff>;

		__overlay__ {
			gpio_init_default = <0x0 0x0 0x0 0x0 0x0 0x0 0x0 0x1 0x0 0x0 0x0 0x0 0x0 0x0 0x2 0x0 0x1 0x0 0x0 0x0 0x0 0x3 0x0 0x0 0x0 0x0 0x0 0x0 0x4 0x0 0x0 0x0 0x0 0x0 0x0 0x5 0x0 0x0 0x0 0x1 0x0 0x0 0x6 0x0 0x1 0x1 0x0 0x0 0x1 0x7 0x0 0x0 0x0 0x1 0x0 0x1 0x8 0x0 0x0 0x0 0x0 0x0 0x1 0x9 0x0 0x0 0x0 0x0 0x0 0x1 0xa 0x0 0x0 0x0 0x1 0x0 0x0 0xb 0x0 0x0 0x0 0x1 0x0 0x0 0xc 0x1 0x1 0x0 0x0 0x0 0x1 0xd 0x1 0x0 0x0 0x0 0x0 0x1 0xe 0x0 0x0 0x0 0x1 0x0 0x0 0xf 0x0 0x0 0x0 0x1 0x0 0x0 0x10 0x0 0x0 0x0 0x1 0x0 0x0 0x11 0x4 0x1 0x0 0x0 0x0 0x0 0x12 0x4 0x1 0x0 0x0 0x0 0x0 0x13 0x4 0x1 0x0 0x0 0x0 0x0 0x14 0x1 0x0 0x0 0x1 0x1 0x0 0x15 0x1 0x0 0x0 0x0 0x0 0x0 0x16 0x0 0x1 0x0 0x0 0x0 0x0 0x17 0x0 0x0 0x0 0x0 0x0 0x0 0x18 0x4 0x1 0x0 0x0 0x0 0x0 0x19 0x0 0x1 0x0 0x0 0x0 0x0 0x1a 0x0 0x1 0x0 0x0 0x0 0x0 0x1b 0x0 0x1 0x0 0x0 0x1 0x0 0x1c 0x0 0x0 0x0 0x0 0x0 0x0 0x1d 0x0 0x0 0x0 0x0 0x0 0x0 0x1e 0x0 0x1 0x0 0x0 0x0 0x0 0x1f 0x1 0x0 0x0 0x0 0x0 0x0 0x20 0x1 0x0 0x0 0x0 0x0 0x0 0x21 0x1 0x0 0x0 0x0 0x0 0x0 0x22 0x1 0x0 0x0 0x0 0x0 0x0 0x23 0x4 0x0 0x0 0x0 0x0 0x0 0x24 0x0 0x0 0x0 0x0 0x0 0x0 0x25 0x0 0x0 0x0 0x0 0x0 0x0 0x26 0x1 0x0 0x0 0x1 0x1 0x1 0x27 0x1 0x0 0x0 0x1 0x0 0x1 0x28 0x1 0x1 0x0 0x1 0x0 0x1 0x29 0x1 0x0 0x0 0x1 0x1 0x1 0x2a 0x1 0x0 0x0 0x1 0x1 0x1 0x2b 0x1 0x0 0x0 0x1 0x1 0x1 0x2c 0x1 0x0 0x0 0x1 0x1 0x1 0x2d 0x1 0x0 0x0 0x1 0x1 0x1 0x2e 0x1 0x0 0x0 0x1 0x1 0x1 0x2f 0x1 0x0 0x0 0x1 0x1 0x1 0x30 0x1 0x0 0x0 0x1 0x1 0x1 0x31 0x1 0x1 0x0 0x1 0x1 0x0 0x32 0x0 0x0 0x0 0x1 0x0 0x0 0x33 0x0 0x0 0x0 0x1 0x0 0x0 0x34 0x0 0x0 0x0 0x1 0x0 0x0 0x35 0x0 0x0 0x0 0x1 0x0 0x0 0x36 0x0 0x0 0x0 0x1 0x0 0x0 0x37 0x1 0x1 0x0 0x1 0x1 0x0 0x38 0x1 0x1 0x0 0x1 0x1 0x0 0x39 0x1 0x1 0x0 0x1 0x0 0x0 0x3a 0x1 0x0 0x0 0x1 0x0 0x0 0x3b 0x1 0x1 0x0 0x1 0x0 0x0 0x3c 0x1 0x1 0x0 0x1 0x0 0x0 0x3d 0x1 0x1 0x0 0x1 0x1 0x0 0x3e 0x1 0x1 0x0 0x0 0x0 0x0 0x3f 0x1 0x1 0x0 0x0 0x0 0x0 0x40 0x1 0x1 0x0 0x0 0x0 0x0 0x41 0x1 0x1 0x0 0x0 0x0 0x0 0x42 0x1 0x0 0x0 0x0 0x0 0x0 0x43 0x1 0x0 0x0 0x0 0x0 0x0 0x44 0x1 0x0 0x0 0x0 0x0 0x0 0x45 0x1 0x0 0x0 0x0 0x0 0x0 0x46 0x1 0x0 0x0 0x1 0x0 0x1 0x47 0x1 0x1 0x0 0x1 0x1 0x1 0x48 0x1 0x1 0x0 0x0 0x0 0x1 0x49 0x1 0x0 0x0 0x1 0x1 0x1 0x4a 0x1 0x0 0x0 0x1 0x1 0x1 0x4b 0x1 0x0 0x0 0x1 0x1 0x1 0x4c 0x1 0x0 0x0 0x1 0x1 0x1 0x4d 0x1 0x1 0x0 0x0 0x0 0x0 0x4e 0x1 0x1 0x0 0x0 0x0 0x0 0x4f 0x1 0x0 0x0 0x1 0x1 0x0 0x50 0x1 0x1 0x0 0x0 0x0 0x0 0x51 0x1 0x1 0x0 0x0 0x0 0x0 0x52 0x1 0x0 0x0 0x1 0x1 0x0 0x53 0x0 0x1 0x0 0x0 0x0 0x0 0x54 0x0 0x0 0x0 0x1 0x0 0x0 0x55 0x0 0x0 0x0 0x1 0x0 0x0 0x56 0x0 0x0 0x0 0x1 0x0 0x0 0x57 0x0 0x0 0x0 0x1 0x0 0x0 0x58 0x1 0x0 0x0 0x0 0x0 0x0 0x59 0x1 0x0 0x0 0x0 0x0 0x0 0x5a 0x0 0x0 0x0 0x0 0x0 0x0 0x5b 0x0 0x0 0x0 0x0 0x0 0x0 0x5c 0x1 0x1 0x0 0x0 0x0 0x0 0x5d 0x1 0x1 0x0 0x0 0x0 0x0 0x5e 0x0 0x0 0x0 0x0 0x0 0x0 0x5f 0x1 0x0 0x0 0x0 0x0 0x0 0x60 0x0 0x1 0x0 0x0 0x0 0x0 0x61 0x1 0x1 0x0 0x0 0x0 0x0 0x62 0x1 0x1 0x0 0x0 0x0 0x0 0x63 0x0 0x0 0x0 0x1 0x0 0x0 0x64 0x1 0x1 0x0 0x1 0x0 0x0 0x65 0x1 0x1 0x0 0x1 0x0 0x0 0x66 0x1 0x1 0x0 0x1 0x0 0x0 0x67 0x1 0x1 0x0 0x1 0x0 0x0 0x68 0x1 0x1 0x0 0x1 0x0 0x0 0x69 0x1 0x1 0x0 0x1 0x0 0x0 0x6a 0x1 0x1 0x0 0x1 0x0 0x0 0x6b 0x1 0x1 0x0 0x1 0x0 0x0 0x6c 0x0 0x0 0x0 0x0 0x0 0x0 0x6d 0x1 0x1 0x0 0x1 0x0 0x0 0x6e 0x0 0x0 0x0 0x1 0x0 0x0 0x6f 0x0 0x0 0x0 0x1 0x0 0x0 0x70 0x0 0x0 0x0 0x0 0x0 0x0 0x71 0x1 0x0 0x0 0x0 0x0 0x0 0x72 0x1 0x0 0x0 0x0 0x0 0x0 0x73 0x1 0x0 0x0 0x0 0x0 0x0 0x74 0x1 0x0 0x0 0x0 0x0 0x0 0x75 0x0 0x1 0x0 0x0 0x0 0x0 0x76 0x0 0x0 0x0 0x0 0x0 0x0 0x77 0x0 0x1 0x0 0x0 0x0 0x0 0x78 0x1 0x0 0x0 0x1 0x1 0x1 0x79 0x1 0x0 0x0 0x1 0x1 0x1 0x7a 0x0 0x1 0x0 0x0 0x0 0x1 0x7b 0x3 0x0 0x0 0x0 0x0 0x0 0x7c 0x3 0x0 0x0 0x0 0x0 0x0 0x7d 0x0 0x1 0x0 0x0 0x0 0x0 0x7e 0x1 0x1 0x0 0x0 0x0 0x0 0x7f 0x1 0x1 0x0 0x0 0x0 0x0 0x80 0x1 0x0 0x0 0x1 0x1 0x0 0x81 0x1 0x0 0x0 0x1 0x1 0x0 0x82 0x1 0x0 0x0 0x0 0x0 0x0 0x83 0x1 0x0 0x0 0x0 0x0 0x0 0x84 0x1 0x0 0x0 0x0 0x0 0x0 0x85 0x1 0x0 0x0 0x0 0x0 0x0 0x86 0x1 0x0 0x0 0x1 0x1 0x0 0x87 0x1 0x0 0x0 0x1 0x1 0x0 0x88 0x0 0x1 0x0 0x0 0x0 0x0 0x89 0x1 0x0 0x0 0x0 0x0 0x0 0x8a 0x1 0x0 0x0 0x0 0x0 0x0 0x8b 0x1 0x0 0x0 0x0 0x0 0x0 0x8c 0x1 0x0 0x0 0x0 0x0 0x0 0x8d 0x1 0x0 0x0 0x0 0x0 0x0 0x8e 0x1 0x0 0x0 0x0 0x0 0x0 0x8f 0x1 0x0 0x0 0x0 0x0 0x0 0x90 0x1 0x1 0x0 0x1 0x0 0x0 0x91 0x1 0x1 0x0 0x1 0x0 0x0 0x92 0x1 0x0 0x0 0x1 0x0 0x0 0x93 0x1 0x1 0x0 0x1 0x0 0x0 0x94 0x1 0x0 0x0 0x1 0x0 0x0 0x95 0x1 0x0 0x0 0x1 0x0 0x0 0x96 0x1 0x0 0x0 0x1 0x0 0x0 0x97 0x1 0x0 0x0 0x1 0x0 0x0 0x98 0x1 0x0 0x0 0x1 0x0 0x0 0x99 0x1 0x0 0x0 0x1 0x0 0x0 0x9a 0x1 0x0 0x0 0x1 0x0 0x0 0x9b 0x1 0x0 0x0 0x1 0x0 0x0 0x9c 0x1 0x0 0x0 0x1 0x0 0x0 0x9d 0x1 0x0 0x0 0x1 0x0 0x0 0x9e 0x1 0x0 0x0 0x1 0x0 0x0 0x9f 0x1 0x0 0x0 0x1 0x0 0x0 0xa0 0x0 0x0 0x0 0x1 0x0 0x0 0xa1 0x0 0x0 0x0 0x1 0x0 0x0 0xa2 0x0 0x0 0x0 0x1 0x0 0x0 0xa3 0x0 0x0 0x0 0x1 0x0 0x0 0xa4 0x0 0x0 0x0 0x1 0x0 0x0 0xa5 0x0 0x0 0x0 0x1 0x0 0x0 0xa6 0x0 0x0 0x0 0x1 0x0 0x0 0xa7 0x0 0x0 0x0 0x1 0x0 0x0 0xa8 0x0 0x0 0x0 0x1 0x0 0x0>;
		};
	};

	fragment@31 {
		target = <0xffffffff>;

		__overlay__ {
			interrupt-parent = <0xffffffff>;
			interrupts = <0x0 0x8 0x0 0x0>;
			status = "okay";
		};
	};

	fragment@32 {
		target = <0xffffffff>;

		__overlay__ {
			force_mode = "SYSRST";
			interrupt-parent = <0xffffffff>;
			mode = "RST";
			status = "okay";
		};
	};

	fragment@33 {
		target = <0xffffffff>;

		__overlay__ {
			interrupt-parent = <0xffffffff>;
			interrupts = <0x4 0x8 0x4 0x0>;
			status = "okay";
		};
	};

	fragment@34 {
		target = <0xffffffff>;

		__overlay__ {
			interrupt-parent = <0xffffffff>;
			interrupts = <0xa 0x8 0xa 0x0>;
			status = "okay";
		};
	};

	fragment@35 {
		target = <0xffffffff>;

		__overlay__ {
			interrupt-parent = <0xffffffff>;
			interrupts = <0x17 0x8 0x17 0x0>;
			status = "okay";
		};
	};

	fragment@36 {
		target = <0xffffffff>;

		__overlay__ {
			interrupt-parent = <0xffffffff>;
			interrupts = <0xb6 0x4 0x3a 0x1>;
			status = "okay";
		};
	};

	fragment@37 {
		target = <0xffffffff>;

		__overlay__ {
			compatible = "mediatek,md1_sim1_hot_plug_eint-eint";
			debounce = <0x0 0x186a0>;
			dedicated = <0x0 0x0>;
			interrupts = <0x0 0x4>;
			sockettype = <0x0 0x0>;
			src_pin = <0x0 0x1>;
			status = "okay";
		};
	};

	fragment@38 {
		target = <0xffffffff>;

		__overlay__ {
			compatible = "mediatek,md1_sim2_hot_plug_eint-eint";
			debounce = <0x1 0x186a0>;
			dedicated = <0x1 0x0>;
			interrupts = <0x1 0x4>;
			sockettype = <0x1 0x0>;
			src_pin = <0x1 0x2>;
			status = "okay";
		};
	};

	fragment@39 {
		target = <0xffffffff>;

		__overlay__ {
			regulator-default-on = <0x1>;
			regulator-name = "vcama";
			status = "okay";
		};
	};

	fragment@4 {
		target = <0xffffffff>;

		__overlay__ {
			pinctrl-0 = <0x1>;
			pinctrl-1 = <0x2>;
			pinctrl-2 = <0x3>;
			pinctrl-3 = <0x4>;
			pinctrl-4 = <0x5>;
			pinctrl-5 = <0x6>;
			pinctrl-names = "mode_te_gpio", "mode_te_te", "lcm_rst_out0_gpio", "lcm_rst_out1_gpio", "lcd_bias_enp0_gpio", "lcd_bias_enp1_gpio";
			status = "okay";
		};
	};

	fragment@40 {
		target = <0xffffffff>;

		__overlay__ {
			regulator-default-on = <0x1>;
			regulator-name = "vsim1";
			status = "okay";
		};
	};

	fragment@41 {
		target = <0xffffffff>;

		__overlay__ {
			regulator-default-on = <0x1>;
			regulator-name = "vsim2";
			status = "okay";
		};
	};

	fragment@42 {
		target = <0xffffffff>;

		__overlay__ {
			regulator-default-on = <0x1>;
			regulator-name = "vcamd";
			status = "okay";
		};
	};

	fragment@43 {
		target = <0xffffffff>;

		__overlay__ {
			regulator-default-on = <0x1>;
			regulator-name = "vcamio";
			status = "okay";
		};
	};

	fragment@44 {
		target = <0xffffffff>;

		__overlay__ {
			regulator-default-on = <0x1>;
			regulator-name = "vldo28";
			status = "okay";
		};
	};

	fragment@45 {
		target = <0xffffffff>;

		__overlay__ {
			status = "okay";
			vcama-supply = <0xffffffff>;
			vcama_sub-supply = <0xffffffff>;
			vcamaf-supply = <0xffffffff>;
			vcamd-supply = <0xffffffff>;
			vcamd_sub-supply = <0xffffffff>;
			vcamio-supply = <0xffffffff>;
			vcamio_sub-supply = <0xffffffff>;
		};
	};

	fragment@46 {
		target = <0xffffffff>;

		__overlay__ {
			status = "okay";
			vtouch-supply = <0xffffffff>;
		};
	};

	fragment@47 {
		target = <0xffffffff>;

		__overlay__ {
			mediatek,kpd-hw-dl-key2 = <0x8>;
			mediatek,kpd-hw-factory-key = <0x1>;
			mediatek,kpd-hw-init-map = <0x0 0x73 0x0 0x0 0x0 0x0 0x0 0x0 0x0 0x0 0x0 0x0 0x0 0x0 0x0 0x0 0x0 0x0 0x0 0x0 0x0 0x0 0x0 0x0 0x0 0x0 0x0 0x0 0x0 0x0 0x0 0x0 0x0 0x0 0x0 0x0 0x0 0x0 0x0 0x0 0x0 0x0 0x0 0x0 0x0 0x0 0x0 0x0 0x0 0x0 0x0 0x0 0x0 0x0 0x0 0x0 0x0 0x0 0x0 0x0 0x0 0x0 0x0 0x0 0x0 0x0 0x0 0x0 0x0 0x0 0x0 0x0>;
			mediatek,kpd-hw-map-num = <0x48>;
			mediatek,kpd-hw-pwrkey = <0x8>;
			mediatek,kpd-hw-recovery-key = <0x11>;
			mediatek,kpd-hw-rstkey = <0x11>;
			mediatek,kpd-key-debounce = <0x400>;
			mediatek,kpd-pwkey-gpio-din = <0x0>;
			mediatek,kpd-pwrkey-eint-gpio = <0x0>;
			mediatek,kpd-sw-pwrkey = <0x74>;
			mediatek,kpd-sw-rstkey = <0x72>;
			mediatek,kpd-use-extend-type = <0x0>;
			status = "okay";
		};
	};

	fragment@48 {
		target = <0xffffffff>;

		__overlay__ {
			gpio_init_default_samsung = <0x5a 0x0 0x0 0x0 0x0 0x0 0x0 0x5b 0x0 0x0 0x0 0x0 0x0 0x0 0x6c 0x0 0x0 0x0 0x0 0x0 0x0 0x70 0x0 0x0 0x0 0x0 0x0 0x0>;
		};
	};

	fragment@49 {
		target = <0xffffffff>;

		__overlay__ {

			camdefault {
				phandle = <0x1f>;
			};

			camera0_mclk_gpio_mode@gpio126 {
				phandle = <0x24>;

				pins_cmd_dat {
					pinmux = <0x7e00>;
				};
			};

			camera0_mclk_on@gpio126 {
				phandle = <0x25>;

				pins_cmd_dat {
					pinmux = <0x7e01>;
				};
			};

			camera0_rst_output_high@gpio27 {
				phandle = <0x21>;

				pins_cmd_dat {
					output-high;
					pinmux = <0x1b00>;
					slew-rate = <0x1>;
				};
			};

			camera0_rst_output_low@gpio27 {
				phandle = <0x20>;

				pins_cmd_dat {
					output-low;
					pinmux = <0x1b00>;
					slew-rate = <0x1>;
				};
			};

			camera0_vcama_output_high@gpio25 {
				phandle = <0x29>;

				pins_cmd_dat {
					output-high;
					pinmux = <0x1900>;
					slew-rate = <0x1>;
				};
			};

			camera0_vcama_output_low@gpio25 {
				phandle = <0x28>;

				pins_cmd_dat {
					output-low;
					pinmux = <0x1900>;
					slew-rate = <0x1>;
				};
			};

			camera0_vcamd_output_high@gpio136 {
				phandle = <0x2b>;

				pins_cmd_dat {
					output-high;
					pinmux = <0x8800>;
					slew-rate = <0x1>;
				};
			};

			camera0_vcamd_output_low@gpio136 {
				phandle = <0x2a>;

				pins_cmd_dat {
					output-low;
					pinmux = <0x8800>;
					slew-rate = <0x1>;
				};
			};

			camera1_mclk_gpio_mode@gpio127 {
				phandle = <0x26>;

				pins_cmd_dat {
					pinmux = <0x7f00>;
				};
			};

			camera1_mclk_on@gpio127 {
				phandle = <0x27>;

				pins_cmd_dat {
					pinmux = <0x7f01>;
				};
			};

			camera1_rst_output_high@gpio22 {
				phandle = <0x23>;

				pins_cmd_dat {
					output-high;
					pinmux = <0x1600>;
					slew-rate = <0x1>;
				};
			};

			camera1_rst_output_low@gpio22 {
				phandle = <0x22>;

				pins_cmd_dat {
					output-low;
					pinmux = <0x1600>;
					slew-rate = <0x1>;
				};
			};
		};
	};

	fragment@5 {
		target = <0xffffffff>;

		__overlay__ {
			accdet-mic-mode = <0x2>;
			accdet-mic-vol = <0x6>;
			accdet-plugout-debounce = <0x1>;
			deb-gpios = <0xffffffff 0xa 0x0>;
			debounce = <0x7d000>;
			headset-eint-level-pol = <0x8>;
			headset-four-key-threshold = <0x0 0x3a 0x79 0xc0 0x190>;
			headset-mode-setting = <0x500 0x500 0x1 0x1f0 0x800 0x800 0x20 0x44>;
			headset-three-key-threshold = <0x0 0x50 0xdc 0x190>;
			headset-three-key-threshold-CDD = <0x0 0x79 0xc0 0x258>;
			headset-vol-threshold = <0x0 0x24e 0x24f 0x690 0xa28>;
			interrupt-parent = <0xffffffff>;
			interrupts = <0xa 0x2008>;
			moisture-ver = <0x1>;
			moisture-water-r = <0xc350>;
			moisture_use_ext_res = <0x1>;
			pinctrl-0 = <0x7>;
			pinctrl-1 = <0x8>;
			pinctrl-names = "default", "state_eint_as_int";
			status = "okay";
		};
	};

	fragment@50 {
		target = <0xffffffff>;

		__overlay__ {
			cam0_enable_sensor = "s5k4hayx_mipi_raw gc8034_mipi_raw";
			cam0_vcamaf-supply = <0xffffffff>;
			cam0_vcamio-supply = <0xffffffff>;
			cam1_enable_sensor = "gc5035_mipi_raw s5k5e9yx_mipi_raw";
			cam1_vcama-supply = <0xffffffff>;
			cam1_vcamd-supply = <0xffffffff>;
			cam1_vcamio-supply = <0xffffffff>;
			pinctrl-0 = <0x1f>;
			pinctrl-1 = <0x20>;
			pinctrl-10 = <0x29>;
			pinctrl-11 = <0x2a>;
			pinctrl-12 = <0x2b>;
			pinctrl-2 = <0x21>;
			pinctrl-3 = <0x22>;
			pinctrl-4 = <0x23>;
			pinctrl-5 = <0x24>;
			pinctrl-6 = <0x25>;
			pinctrl-7 = <0x26>;
			pinctrl-8 = <0x27>;
			pinctrl-9 = <0x28>;
			pinctrl-names = "default", "cam0_rst0", "cam0_rst1", "cam1_rst0", "cam1_rst1", "cam0_mclk_off", "cam0_mclk_on", "cam1_mclk_off", "cam1_mclk_on", "cam0_vcama_off", "cam0_vcama_on", "cam0_vcamd_off", "cam0_vcamd_on";
			status = "okay";

			vendor {
				check_sensor_vendor;
				front_sensor_id = <0xd2>;
				max_camera_num = <0x2>;
				max_supported_camera = <0x2>;
				need_i2c_config;
				rear_sensor_id = <0x27>;
				supported_cameraId = <0x0 0x1>;
				use_module_check;

				camera_info0 {
					cal_memory = <0x2>;
					companion = <0x0>;
					core_voltage = <0x0>;
					dual_open = <0x0>;
					isp = <0x0>;
					ois = <0x0>;
					position = <0x0>;
					read_version = <0x0>;
					upgrade = <0x0>;
					valid = <0x1>;
				};

				camera_info1 {
					cal_memory = <0x3>;
					companion = <0x0>;
					core_voltage = <0x0>;
					dual_open = <0x0>;
					isp = <0x0>;
					ois = <0x0>;
					position = <0x1>;
					read_version = <0x0>;
					upgrade = <0x0>;
					valid = <0x1>;
				};
			};
		};
	};

	fragment@51 {
		target = <0xffffffff>;

		__overlay__ {
			#address-cells = <0x1>;
			#size-cells = <0x0>;
			clock-frequency = <0x61a80>;
			mediatek,use-open-drain;

			camera_main@10 {
				compatible = "mediatek,camera_main";
				phandle = <0x4b>;
				reg = <0x10>;
				status = "okay";
			};
		};
	};

	fragment@52 {
		target = <0xffffffff>;

		__overlay__ {
			#address-cells = <0x1>;
			#size-cells = <0x0>;
			clock-frequency = <0x61a80>;
			mediatek,use-open-drain;

			camera_main_af@0c {
				compatible = "mediatek,camera_main_af";
				phandle = <0x4d>;
				reg = <0xc>;
				status = "okay";
			};

			camera_main_eeprom@58 {
				compatible = "mediatek,camera_main_eeprom";
				phandle = <0x4c>;
				reg = <0x58>;
				status = "okay";
			};

			camera_sub@37 {
				compatible = "mediatek,camera_sub";
				phandle = <0x4e>;
				reg = <0x37>;
				status = "okay";
			};

			camera_sub_eeprom@38 {
				compatible = "mediatek,camera_sub_eeprom";
				phandle = <0x4f>;
				reg = <0x38>;
				status = "okay";
			};
		};
	};

	fragment@53 {
		target = <0xffffffff>;

		__overlay__ {

			fg_alert_default {
				phandle = <0x2c>;

				pins_cmd_dat {
					bias-disable;
					pinmux = <0x900>;
					slew-rate = <0x0>;
				};
			};
		};
	};

	fragment@54 {
		target = <0xffffffff>;

		__overlay__ {

			s2mu005-fuelgauge@3b {
				compatible = "samsung,s2mu005-fuelgauge";
				fuelgauge,capacity_calculation_type = <0x1c>;
				fuelgauge,capacity_full = <0xbb8>;
				fuelgauge,capacity_max = <0x3e8>;
				fuelgauge,capacity_max_margin = <0xc8>;
				fuelgauge,capacity_min = <0x0>;
				fuelgauge,fg_log_enable = <0x1>;
				fuelgauge,fuel_alert_soc = <0x1>;
				fuelgauge,fuel_alert_vol = <0xce4>;
				fuelgauge,fuel_int = <0xffffffff 0x9 0x0>;
				fuelgauge,i_socr_coeff = <0x54>;
				fuelgauge,low_temp_limit = <0x64>;
				fuelgauge,low_voltage_limit_lowtemp = <0xc1c>;
				fuelgauge,sw_vbat_l_recovery_vol = <0xd89>;
				fuelgauge,type_str = "SDI";
				pinctrl-0 = <0x2c>;
				pinctrl-names = "fg_alert_default";
				reg = <0x3b>;
				status = "okay";
			};
		};
	};

	fragment@55 {
		target = <0xffffffff>;

		__overlay__ {

			if_pmic_irq {
				phandle = <0x30>;

				pins_cmd_dat {
					bias-disable;
					input-enable;
					pinmux = <0x300>;
				};
			};
		};
	};

	fragment@56 {
		target = <0xffffffff>;

		__overlay__ {
			#address-cells = <0x1>;
			#size-cells = <0x0>;
			clock-frequency = <0x61a80>;
			mediatek,use-open-drain;
			status = "okay";

			s2mu005@3D {
				compatible = "samsung,s2mu005mfd";
				pinctrl-0 = <0x30>;
				pinctrl-names = "default";
				reg = <0x3d>;
				s2mu005,irq-gpio = <0xffffffff 0x3 0x1>;
				s2mu005,wakeup;
				status = "okay";
			};
		};
	};

	fragment@57 {
		target = <0xffffffff>;

		__overlay__ {
			#address-cells = <0x1>;
			#size-cells = <0x0>;
			clock-frequency = <0x61a80>;
			status = "okay";

			speaker_amp@34 {
				compatible = "mediatek,speaker_amp";
				reg = <0x34>;
				reset-gpio = <0xffffffff 0x5f 0x0>;
				status = "okay";
			};
		};
	};

	fragment@58 {
		target = <0xffffffff>;

		__overlay__ {
			accdet-mic-mode = <0x1>;
			headset-four-key-threshold = <0x0 0xa0 0xbe 0x10e 0x1f4>;
			headset-vol-threshold = <0x0 0x258 0x259 0x7d0 0xa28>;
		};
	};

	fragment@59 {
		target = <0xffffffff>;

		__overlay__ {

			acc_int {
				phandle = <0x2f>;

				pins_cmd_dat {
					bias-disable;
					pinmux = <0x800>;
					slew-rate = <0x0>;
				};
			};

			sensor_i2c {
				phandle = <0x2e>;

				pins_cmd0_dat {
					bias-disable;
					pinmux = <0x1c00>;
					slew-rate = <0x0>;
				};

				pins_cmd1_dat {
					bias-disable;
					pinmux = <0x1e00>;
					slew-rate = <0x0>;
				};
			};

			sensor_ldo_1p8_en {
				phandle = <0x2d>;

				pins_cmd_dat {
					output-high;
					pinmux = <0x6000>;
					slew-rate = <0x1>;
				};
			};
		};
	};

	fragment@6 {
		target = <0xffffffff>;

		__overlay__ {

			accdetdefault {
				phandle = <0x7>;
			};

			accdeteint@0 {
				phandle = <0x8>;

				pins_cmd_dat {
					bias-pull-up;
					pinmux = <0xa00>;
					slew-rate = <0x0>;
				};
			};
		};
	};

	fragment@60 {
		target = <0xffffffff>;

		__overlay__ {

			spi_clk_init {
				phandle = <0x33>;

				pins_cmd_dat {
					bias-disable;
					pinmux = <0x2001>;
				};
			};

			spi_clk_sleep {
				phandle = <0x38>;

				pins_cmd_dat {
					bias-pull-down;
					pinmux = <0x2000>;
					slew-rate = <0x0>;
				};
			};

			spi_cs_init {
				phandle = <0x32>;

				pins_cmd_dat {
					bias-disable;
					pinmux = <0x1f01>;
				};
			};

			spi_cs_sleep {
				phandle = <0x37>;

				pins_cmd_dat {
					bias-pull-down;
					pinmux = <0x1f00>;
					slew-rate = <0x0>;
				};
			};

			spi_miso_init {
				phandle = <0x34>;

				pins_cmd_dat {
					bias-disable;
					pinmux = <0x2101>;
				};
			};

			spi_miso_sleep {
				phandle = <0x39>;

				pins_cmd_dat {
					bias-pull-down;
					pinmux = <0x2100>;
					slew-rate = <0x0>;
				};
			};

			spi_mosi_init {
				phandle = <0x35>;

				pins_cmd_dat {
					bias-disable;
					pinmux = <0x2201>;
				};
			};

			spi_mosi_sleep {
				phandle = <0x3a>;

				pins_cmd_dat {
					bias-pull-down;
					pinmux = <0x2200>;
					slew-rate = <0x0>;
				};
			};

			ts_pin_init {
				phandle = <0x31>;

				pins_cmd_dat {
					bias-disable;
					pinmux = <0x0>;
					slew-rate = <0x0>;
				};
			};

			ts_pin_sleep {
				phandle = <0x36>;

				pins_cmd_dat {
					bias-pull-down = <0x65>;
					pinmux = <0x0>;
					slew-rate = <0x0>;
				};
			};
		};
	};

	fragment@61 {
		target = <0xffffffff>;

		__overlay__ {
			#address-cells = <0x1>;
			#size-cells = <0x0>;
			num-cs = <0x2>;
			status = "okay";

			novatek@1 {
				compatible = "novatek,NVT-ts-spi";
				novatek,irq-gpio = <0xffffffff 0x0 0x2001>;
				novatek,mp-support-dt;
				novatek,spi-rd-fast-addr = <0x3f310>;
				novatek,swrst-n8-addr = <0x3f0fe>;
				pinctrl-0 = <0x31 0x32 0x33 0x34 0x35>;
				pinctrl-1 = <0x36 0x37 0x38 0x39 0x3a>;
				pinctrl-names = "on_state", "off_state";
				reg = <0x1>;
				spi-max-frequency = <0x927c00>;
				status = "okay";
				support_ear_detect_mode;

				novatek-mp-criteria-720D@0 {
					#address-cells = <0x1>;
					#size-cells = <0x0>;
					AIN_KEY = <0x0 0x1 0x2 0xff>;
					AIN_X = <0x0 0x1 0x2 0x3 0x4 0x5 0x6 0x7 0x8 0x9 0xa 0xb 0xc 0xd 0xe 0xf 0x10 0x11>;
					AIN_Y = <0x0 0x1 0x2 0x3 0x4 0x5 0x6 0x7 0x8 0x9 0xa 0xb 0xc 0xd 0xe 0xf 0x10 0x11 0x12 0x13 0x14 0x15 0x16 0x17 0x18 0x19 0x1a 0x1b 0x1c 0x1d 0x1e 0x1f>;
					IC_KEY_CFG_SIZE = <0x4>;
					IC_X_CFG_SIZE = <0x12>;
					IC_Y_CFG_SIZE = <0x20>;
					X_Channel = <0x12>;
					Y_Channel = <0x20>;
					compatible = "novatek-mp-criteria-720D";
					diff_test_frame = <0x32>;
					open_test_spec = <0xfffffe01 0x1400>;
					short_test_spec = <0x2710 0x36b8>;
				};
			};

			synaptics_tcm@0 {
				compatible = "synaptics,tcm-spi";
				interrupt-parent = <0xffffffff>;
				interrupts = <0x0 0x2008>;
				pinctrl-0 = <0x31 0x32 0x33 0x34 0x35>;
				pinctrl-1 = <0x36 0x37 0x38 0x39 0x3a>;
				pinctrl-names = "on_state", "off_state";
				reg = <0x0>;
				spi-max-frequency = <0x4c4b40>;
				status = "okay";
				support_ear_detect_mode;
				synaptics,block-delay-us = <0x0>;
				synaptics,bus-reg-name = "vdd";
				synaptics,byte-delay-us = <0x0>;
				synaptics,fw_name = "tsp_synaptics/td4150_a01core.img";
				synaptics,irq-gpio = <0xffffffff 0x0 0x2008>;
				synaptics,irq-on-state = <0x0>;
				synaptics,power-delay-ms = <0xc8>;
				synaptics,pwr-reg-name = "avdd";
				synaptics,reset-active-ms = <0x14>;
				synaptics,reset-delay-ms = <0xc8>;
				synaptics,reset-on-state = <0x0>;
				synaptics,spi-mode = <0x0>;
				synaptics,ubl-byte-delay-us = <0x14>;
				synaptics,ubl-max-freq = <0x4c4b40>;
			};
		};
	};

	fragment@62 {
		target = <0xffffffff>;

		__overlay__ {

			lcd_bc_ctrl_init {
				phandle = <0x3e>;

				pins_cmd_dat {
					bias-disable;
					pinmux = <0x1d00>;
					slew-rate = <0x0>;
				};
			};

			lcd_bc_ctrl_sleep {
				phandle = <0x3d>;

				pins_cmd_dat {
					bias-pull-down;
					pinmux = <0x1d00>;
					slew-rate = <0x0>;
				};
			};
		};
	};

	fragment@63 {
		target = <0xffffffff>;

		__overlay__ {
			cd-gpios = <0xffffffff 0x17 0x0>;
		};
	};

	fragment@7 {
		target = <0xffffffff>;

		__overlay__ {
			cd-gpios = <0xffffffff 0x17 0x0>;
			cd_level = [00];
		};
	};

	fragment@8 {
		target = <0xffffffff>;

		__overlay__ {

			consys_default {
				phandle = <0x9>;
			};

			gpslna@0 {
				phandle = <0xa>;

				pins_cmd_dat {
					bias-disable;
					output-low;
					pinmux = <0x7d00>;
					slew-rate = <0x1>;
				};
			};

			gpslna@1 {
				phandle = <0xb>;

				pins_cmd_dat {
					output-high;
					pinmux = <0x7d00>;
					slew-rate = <0x1>;
				};
			};

			gpslna@2 {
				phandle = <0xc>;

				pins_cmd_dat {
					output-low;
					pinmux = <0x7d00>;
					slew-rate = <0x1>;
				};
			};
		};
	};

	fragment@9 {
		target = <0xffffffff>;

		__overlay__ {
			pinctrl-0 = <0x9>;
			pinctrl-1 = <0xa>;
			pinctrl-2 = <0xb>;
			pinctrl-3 = <0xc>;
			pinctrl-names = "default", "gps_lna_state_init", "gps_lna_state_oh", "gps_lna_state_ol";
			status = "okay";
		};
	};

	fragment@abc {
		target-path = [2f 00];

		__overlay__ {

			abc_hub {
				compatible = "samsung,abc_hub";
				status = "okay";

				bootc {
					bootc,time_spec_eng = <0x249f0>;
					bootc,time_spec_fac = <0x186a0>;
					bootc,time_spec_user = <0x186a0>;
				};
			};

			sec_abc {
				compatible = "samsung,sec_abc";
				status = "okay";

				aicl {
					aicl,label = "battery aicl";
					aicl,threshold_count = <0x5>;
					aicl,threshold_time = <0x12c>;
				};

				gpu {
					gpu,label = "GPU fault";
					gpu,threshold_count = <0x4>;
					gpu,threshold_time = <0x4b0>;
				};

				gpu_page {
					gpu_page,label = "GPU page fault";
					gpu_page,threshold_count = <0x14>;
					gpu_page,threshold_time = <0x4b0>;
				};
			};
		};
	};

	fragment@battery {
		target-path = [2f 00];

		__overlay__ {

			battery {
				battery,adc_check_count = <0x5>;
				battery,age_data = <0x0 0x10fe 0x109a 0x109a 0x5d 0x12c 0x10ea 0x1086 0x1086 0x5c 0x190 0x10d6 0x1072 0x1072 0x5b 0x2bc 0x10c2 0x105e 0x105e 0x5a 0x3e8 0x1090 0x102c 0x102c 0x59>;
				battery,bat_thm_adc_channel = <0x1>;
				battery,battery_check_type = <0x0>;
				battery,battery_full_capacity = <0xbb8>;
				battery,cable_check_type = <0x4>;
				battery,cable_source_type = <0x1>;
				battery,charger_name = "s2mu005-charger";
				battery,charging_reset_time = <0x0>;
				battery,charging_total_time = <0x5460>;
				battery,check_count = <0x0>;
				battery,chg_charging_limit_current = <0x3e8>;
				battery,chg_float_voltage = <0x10fe>;
				battery,chg_float_voltage_conv = <0x1>;
				battery,chg_gpio_full_check = <0x0>;
				battery,chg_heating_prevention_method = <0x1>;
				battery,chg_high_temp = <0x1cc>;
				battery,chg_high_temp_recovery = <0x1b8>;
				battery,chg_input_limit_current = <0x3e8>;
				battery,chg_polarity_full_check = <0x1>;
				battery,chg_thermal_source = <0x4>;
				battery,chip_vendor = "LSI";
				battery,cisd_alg_index = <0x8>;
				battery,cisd_max_voltage_thr = <0x1388>;
				battery,expired_time = <0x4b00>;
				battery,fgsrc_switch_name = "s2mu005-fuelgauge";
				battery,fuelgauge_name = "s2mu005-fuelgauge";
				battery,full_check_count = <0x1>;
				battery,full_check_type = <0x2>;
				battery,full_check_type_2nd = <0x2>;
				battery,full_condition_soc = <0x5d>;
				battery,full_condition_type = <0xd>;
				battery,full_condition_vcell = <0x109a>;
				battery,health_condition = <0x384 0x4b 0x4b0 0x41 0x5dc 0x37>;
				battery,high_temp_float = <0x1036>;
				battery,high_temp_topoff = <0x96>;
				battery,hv_charging_total_time = <0x2a30>;
				battery,ignore_cisd_index = <0x0 0x3c0>;
				battery,ignore_cisd_index_d = <0x0 0x78>;
				battery,inbat_voltage = <0x1>;
				battery,inbat_voltage_table_adc = <0xb16 0xaf4 0xad7 0xabe 0xa9e 0xa83 0xa6d 0xa4e 0xa37 0xa14 0x9f5 0x9d9 0x9bd 0x99e 0x983 0x96d 0x94f 0x935 0x915 0x8f9 0x8db 0x8c1 0x8a3 0x887 0x86e 0x850 0x834 0x816>;
				battery,inbat_voltage_table_data = <0x10fe 0x10cc 0x109a 0x1068 0x1036 0x1004 0xfd2 0xfa0 0xf6e 0xf3c 0xf0a 0xed8 0xea6 0xe74 0xe42 0xe10 0xdde 0xdac 0xd7a 0xd48 0xd16 0xce4 0xcb2 0xc80 0xc4e 0xc1c 0xbea 0xbb8>;
				battery,input_current_by_siop_0 = <0x3e8>;
				battery,input_current_by_siop_10 = <0x320>;
				battery,input_current_by_siop_20 = <0x3e8>;
				battery,low_temp_float = <0x10fe>;
				battery,low_temp_topoff = <0x96>;
				battery,max_input_current = <0x2bc>;
				battery,max_input_voltage = <0x1388>;
				battery,mix_high_chg_temp = <0x1f4>;
				battery,mix_high_temp = <0x1a4>;
				battery,mix_high_temp_recovery = <0x186>;
				battery,monitor_initial_count = <0x0>;
				battery,normal_charging_total_time = <0x4650>;
				battery,overheatlimit_recovery = <0x2a8>;
				battery,overheatlimit_threshold = <0x2bc>;
				battery,ovp_uvlo_check_type = <0x3>;
				battery,polling_time = <0xa 0x1e 0x1e 0x1e 0xe10>;
				battery,polling_type = <0x1>;
				battery,recharge_check_count = <0x1>;
				battery,recharge_condition_soc = <0x62>;
				battery,recharge_condition_type = <0x4>;
				battery,recharge_condition_vcell = <0x109a>;
				battery,recharging_expired_time = <0x1518>;
				battery,recharging_total_time = <0x1518>;
				battery,siop_call_cc_current = <0x14a>;
				battery,siop_call_cv_current = <0x14a>;
				battery,siop_charging_limit_current = <0x3e8>;
				battery,siop_event_check_type = <0x1>;
				battery,siop_input_limit_current = <0x3e8>;
				battery,standard_curr = <0x2dc>;
				battery,swelling_high_rechg_voltage = <0xfa0>;
				battery,swelling_low_rechg_voltage = <0x1068>;
				battery,technology = <0x2>;
				battery,temp_adc_type = <0x1>;
				battery,temp_check_count = <0x1>;
				battery,temp_check_type = <0x2>;
				battery,temp_gap_bat_usb = <0xc8>;
				battery,temp_table_adc = <0x75 0x82 0xb9 0xdb 0x104 0x13a 0x17b 0x1c8 0x227 0x266 0x297 0x33a 0x393 0x3df 0x4a1 0x585 0x692 0x7b6 0x866 0x902 0x9d8 0xa2f 0xb79 0xcb2 0xdeb>;
				battery,temp_table_data = <0x352 0x320 0x2bc 0x28a 0x258 0x226 0x1f4 0x1c2 0x190 0x172 0x15e 0x12c 0x10e 0xfa 0xc8 0x96 0x64 0x32 0x1e 0x0 0xffffffe2 0xffffffce 0xffffff9c 0xffffff6a 0xffffff38>;
				battery,thermal_source = <0x2>;
				battery,usb_charging_total_time = <0x8ca0>;
				battery,usb_protection_temp = <0x262>;
				battery,vendor = "Battery";
				battery,wire_cold_cool3_thresh = <0x0>;
				battery,wire_cool1_current = <0x2bc>;
				battery,wire_cool1_normal_thresh = <0x96>;
				battery,wire_cool2_cool1_thresh = <0x96>;
				battery,wire_cool2_current = <0x2bc>;
				battery,wire_cool3_cool2_thresh = <0x32>;
				battery,wire_cool3_current = <0xfa>;
				battery,wire_normal_warm_thresh = <0x19a>;
				battery,wire_warm_current = <0x41a>;
				battery,wire_warm_overheat_thresh = <0x1f4>;
				compatible = "samsung,sec-battery";
				pinctrl-names = "default";
				status = "okay";
			};

			battery_params {
				battery,FG_Accumulative_rate_evt2 = <0x0 0x8>;
				battery,batcap = <0x2b 0x14 0x8 0x13>;
				battery,battery_data = <0x6 0xb 0x84 0xa 0x1 0xa 0x8a 0x9 0x17 0x9 0xab 0x8 0x46 0x8 0xe9 0x7 0x9b 0x7 0x3d 0x7 0xdf 0x6 0xa9 0x6 0x80 0x6 0x60 0x6 0x46 0x6 0x2a 0x6 0x1 0x6 0xd3 0x5 0x92 0x5 0x7b 0x5 0xdf 0x3 0x7 0x2 0x6b 0x8 0x0 0x8 0x95 0x7 0x2b 0x7 0xc0 0x6 0x55 0x6 0xeb 0x5 0x80 0x5 0x15 0x5 0xab 0x4 0x40 0x4 0xd5 0x3 0x6b 0x3 0x0 0x3 0x95 0x2 0x2b 0x2 0xc0 0x1 0x55 0x1 0xeb 0x0 0x80 0x0 0x15 0x0 0xf1 0xf 0xa 0xa 0xa 0xa 0x30 0x2f 0x30 0x2f 0x2f 0x2f 0x2f 0x30 0x31 0x32 0x33 0x36 0x39 0x40 0x4d 0x6a 0x9e 0xdd 0x2b 0x14 0x8 0x13 0x0 0x8 0x2919 0x2710 0x2507 0x22fe 0x20f6 0x1eed 0x1ce4 0x1adb 0x18d2 0x16c9 0x14c0 0x12b7 0x10af 0xea6 0xc9d 0xa94 0x88b 0x683 0x47a 0x271 0x68 0xffffffb5 0xab02 0xa886 0xa60b 0xa3c2 0xa192 0x9f82 0x9d93 0x9bd2 0x9a54 0x9887 0x96bc 0x95b7 0x94ee 0x9450 0x93d3 0x934b 0x9283 0x91a1 0x9062 0x8ff2 0x8818 0x7f18 0x0 0x6 0xb 0x84 0xa 0x1 0xa 0x8a 0x9 0x17 0x9 0xab 0x8 0x46 0x8 0xe9 0x7 0x9b 0x7 0x3d 0x7 0xdf 0x6 0xa9 0x6 0x80 0x6 0x60 0x6 0x46 0x6 0x2a 0x6 0x1 0x6 0xd3 0x5 0x92 0x5 0x7b 0x5 0xdf 0x3 0x7 0x2 0x84 0x8 0x18 0x8 0xac 0x7 0x41 0x7 0xd5 0x6 0x69 0x6 0xfd 0x5 0x91 0x5 0x25 0x5 0xb9 0x4 0x4d 0x4 0xe1 0x3 0x75 0x3 0x9 0x3 0x9d 0x2 0x31 0x2 0xc5 0x1 0x59 0x1 0xed 0x0 0x82 0x0 0x16 0x0 0xf0 0xf 0xa 0xa 0xa 0xa 0x30 0x2f 0x30 0x2f 0x2f 0x2f 0x2f 0x30 0x31 0x32 0x33 0x36 0x39 0x40 0x4d 0x6a 0x9e 0xdd 0x2b 0x48 0x8 0x1d 0x0 0x8 0x2996 0x2787 0x2578 0x2369 0x215a 0x1f4b 0x1d3c 0x1b2d 0x191e 0x170f 0x1500 0x12f1 0x10e1 0xed2 0xcc3 0xab4 0x8a5 0x696 0x487 0x278 0x69 0xffffffb4 0xab02 0xa886 0xa60b 0xa3c2 0xa192 0x9f82 0x9d93 0x9bd2 0x9a54 0x9887 0x96bc 0x95b7 0x94ee 0x9450 0x93d3 0x934b 0x9283 0x91a1 0x9062 0x8ff2 0x8818 0x7f18 0x0 0x6 0xb 0x84 0xa 0x1 0xa 0x8a 0x9 0x17 0x9 0xab 0x8 0x46 0x8 0xe9 0x7 0x9b 0x7 0x3d 0x7 0xdf 0x6 0xa9 0x6 0x80 0x6 0x60 0x6 0x46 0x6 0x2a 0x6 0x1 0x6 0xd3 0x5 0x92 0x5 0x7b 0x5 0xdf 0x3 0x7 0x2 0xcb 0x8 0x5c 0x8 0xec 0x7 0x7d 0x7 0xd 0x7 0x9e 0x6 0x2e 0x6 0xbf 0x5 0x4f 0x5 0xe0 0x4 0x71 0x4 0x1 0x4 0x92 0x3 0x22 0x3 0xb3 0x2 0x43 0x2 0xd4 0x1 0x65 0x1 0xf5 0x0 0x86 0x0 0x16 0x0 0xf0 0xf 0xa 0xa 0xa 0xa 0x30 0x2f 0x30 0x2f 0x2f 0x2f 0x2f 0x30 0x31 0x32 0x33 0x36 0x39 0x40 0x4d 0x6a 0x9e 0xdd 0x29 0xec 0x7 0xdc 0x0 0x8 0x2af0 0x28d0 0x26af 0x248f 0x226f 0x204f 0x1e2f 0x1c0e 0x19ee 0x17ce 0x15ae 0x138e 0x116e 0xf4e 0xd2d 0xb0d 0x8ed 0x6cd 0x4ad 0x28d 0x6d 0xffffffb1 0xab02 0xa886 0xa60b 0xa3c2 0xa192 0x9f82 0x9d93 0x9bd2 0x9a54 0x9887 0x96bc 0x95b7 0x94ee 0x9450 0x93d3 0x934b 0x9283 0x91a1 0x9062 0x8ff2 0x8818 0x7f18 0x0 0x6 0xb 0x84 0xa 0x1 0xa 0x8a 0x9 0x17 0x9 0xab 0x8 0x46 0x8 0xe9 0x7 0x9b 0x7 0x3d 0x7 0xdf 0x6 0xa9 0x6 0x80 0x6 0x60 0x6 0x46 0x6 0x2a 0x6 0x1 0x6 0xd3 0x5 0x92 0x5 0x7b 0x5 0xdf 0x3 0x7 0x2 0xa6 0x8 0x38 0x8 0xcb 0x7 0x5d 0x7 0xf0 0x6 0x82 0x6 0x14 0x6 0xa7 0x5 0x39 0x5 0xcb 0x4 0x5e 0x4 0xf0 0x3 0x83 0x3 0x15 0x3 0xa7 0x2 0x3a 0x2 0xcc 0x1 0x5f 0x1 0xf1 0x0 0x84 0x0 0x16 0x0 0xf0 0xf 0xa 0xa 0xa 0xa 0x30 0x2f 0x30 0x2f 0x2f 0x2f 0x2f 0x30 0x31 0x32 0x33 0x36 0x39 0x40 0x4d 0x6a 0x9e 0xdd 0x2a 0xa0 0x7 0xfe 0x0 0x8 0x2a3a 0x2823 0x260c 0x23f5 0x21de 0x1fc7 0x1daf 0x1b98 0x1981 0x1769 0x1552 0x133b 0x1124 0xf0d 0xcf6 0xadf 0x8c8 0x6b0 0x499 0x282 0x6b 0xffffffb3 0xab02 0xa886 0xa60b 0xa3c2 0xa192 0x9f82 0x9d93 0x9bd2 0x9a54 0x9887 0x96bc 0x95b7 0x94ee 0x9450 0x93d3 0x934b 0x9283 0x91a1 0x9062 0x8ff2 0x8818 0x7f18 0x0 0x6 0xb 0x84 0xa 0x1 0xa 0x8a 0x9 0x17 0x9 0xab 0x8 0x46 0x8 0xe9 0x7 0x9b 0x7 0x3d 0x7 0xdf 0x6 0xa9 0x6 0x80 0x6 0x60 0x6 0x46 0x6 0x2a 0x6 0x1 0x6 0xd3 0x5 0x92 0x5 0x7b 0x5 0xdf 0x3 0x7 0x2 0x35 0x9 0xc0 0x8 0x4b 0x8 0xd7 0x7 0x62 0x7 0xed 0x6 0x79 0x6 0x4 0x6 0x8f 0x5 0x1b 0x5 0xa6 0x4 0x31 0x4 0xbd 0x3 0x48 0x3 0xd3 0x2 0x5f 0x2 0xea 0x1 0x75 0x1 0x1 0x1 0x8c 0x0 0x17 0x0 0xef 0xf 0xa 0xa 0xa 0xa 0x30 0x2f 0x30 0x2f 0x2f 0x2f 0x2f 0x30 0x31 0x32 0x33 0x36 0x39 0x40 0x4d 0x6a 0x9e 0xdd 0x28 0xc 0x7 0x82 0x0 0x8 0x2cf3 0x2ab9 0x287f 0x2646 0x240c 0x21d3 0x1f99 0x1d5f 0x1b25 0x18ec 0x16b2 0x1478 0x123f 0x1005 0xdcc 0xb92 0x958 0x71f 0x4e5 0x2ac 0x72 0xffffffae 0xab02 0xa886 0xa60b 0xa3c2 0xa192 0x9f82 0x9d93 0x9bd2 0x9a54 0x9887 0x96bc 0x95b7 0x94ee 0x9450 0x93d3 0x934b 0x9283 0x91a1 0x9062 0x8ff2 0x8818 0x7f18 0x0>;
				battery,battery_table1 = <0x6 0xb 0x84 0xa 0x1 0xa 0x8a 0x9 0x17 0x9 0xab 0x8 0x46 0x8 0xe9 0x7 0x9b 0x7 0x3d 0x7 0xdf 0x6 0xa9 0x6 0x80 0x6 0x60 0x6 0x46 0x6 0x2a 0x6 0x1 0x6 0xd3 0x5 0x92 0x5 0x7b 0x5 0xdf 0x3 0x7 0x2 0x6b 0x8 0x0 0x8 0x95 0x7 0x2b 0x7 0xc0 0x6 0x55 0x6 0xeb 0x5 0x80 0x5 0x15 0x5 0xab 0x4 0x40 0x4 0xd5 0x3 0x6b 0x3 0x0 0x3 0x95 0x2 0x2b 0x2 0xc0 0x1 0x55 0x1 0xeb 0x0 0x80 0x0 0x15 0x0 0xf1 0xf>;
				battery,battery_table2 = <0xa 0xa 0xa 0xa 0x30 0x2f 0x30 0x2f 0x2f 0x2f 0x2f 0x30 0x31 0x32 0x33 0x36 0x39 0x40 0x4d 0x6a 0x9e 0xdd>;
				battery,battery_table3 = <0x6 0xb 0x84 0xa 0x1 0xa 0x8a 0x9 0x17 0x9 0xab 0x8 0x46 0x8 0xe9 0x7 0x9b 0x7 0x3d 0x7 0xdf 0x6 0xa9 0x6 0x80 0x6 0x60 0x6 0x46 0x6 0x2a 0x6 0x1 0x6 0xd3 0x5 0x92 0x5 0x7b 0x5 0xdf 0x3 0x7 0x2 0x6b 0x8 0x0 0x8 0x95 0x7 0x2b 0x7 0xc0 0x6 0x55 0x6 0xeb 0x5 0x80 0x5 0x15 0x5 0xab 0x4 0x40 0x4 0xd5 0x3 0x6b 0x3 0x0 0x3 0x95 0x2 0x2b 0x2 0xc0 0x1 0x55 0x1 0xeb 0x0 0x80 0x0 0x15 0x0 0xf1 0xf>;
				battery,battery_table4 = <0xa 0xa 0xa 0xa 0x30 0x2f 0x30 0x2f 0x2f 0x2f 0x2f 0x30 0x31 0x32 0x33 0x36 0x39 0x40 0x4d 0x6a 0x9e 0xdd>;
				battery,data_ver = <0x4>;
				battery,ocv_arr_evt1 = <0xab02 0xa886 0xa60b 0xa3c2 0xa192 0x9f82 0x9d93 0x9bd2 0x9a54 0x9887 0x96bc 0x95b7 0x94ee 0x9450 0x93d3 0x934b 0x9283 0x91a1 0x9062 0x8ff2 0x8818 0x7f18>;
				battery,ocv_arr_evt2 = <0xab02 0xa886 0xa60b 0xa3c2 0xa192 0x9f82 0x9d93 0x9bd2 0x9a54 0x9887 0x96bc 0x95b7 0x94ee 0x9450 0x93d3 0x934b 0x9283 0x91a1 0x9062 0x8ff2 0x8818 0x7f18>;
				battery,soc_arr_evt1 = <0x2919 0x2710 0x2507 0x22fe 0x20f6 0x1eed 0x1ce4 0x1adb 0x18d2 0x16c9 0x14c0 0x12b7 0x10af 0xea6 0xc9d 0xa94 0x88b 0x683 0x47a 0x271 0x68 0xffffffb5>;
				battery,soc_arr_evt2 = <0x2919 0x2710 0x2507 0x22fe 0x20f6 0x1eed 0x1ce4 0x1adb 0x18d2 0x16c9 0x14c0 0x12b7 0x10af 0xea6 0xc9d 0xa94 0x88b 0x683 0x47a 0x271 0x68 0xffffffb5>;
				battery,tunning = <0x0>;
			};

			cable-info {
				default_charging_current = <0x3e8>;
				default_input_current = <0x2bc>;
				full_check_current_1st = <0x12c>;
				full_check_current_2nd = <0x96>;

				current_group_1 {
					cable_number = <0x1 0x4 0x13 0x15 0x16 0x17 0x1e>;
					charging_current = <0x1f4>;
					input_current = <0x1f4>;
				};

				current_group_10 {
					cable_number = <0xb 0x10 0x1c>;
					charging_current = <0x4b0>;
					input_current = <0x28a>;
				};

				current_group_11 {
					cable_number = <0x1d>;
					charging_current = <0x4b0>;
					input_current = <0x1f4>;
				};

				current_group_2 {
					cable_number = <0x2 0x19 0x1f>;
					charging_current = <0x3e8>;
					input_current = <0x3e8>;
				};

				current_group_3 {
					cable_number = <0x5 0x20>;
					charging_current = <0x4b0>;
					input_current = <0x384>;
				};

				current_group_4 {
					cable_number = <0x6 0x7 0x8>;
					charging_current = <0x866>;
					input_current = <0x672>;
				};

				current_group_5 {
					cable_number = <0x9>;
					charging_current = <0x866>;
					input_current = <0x672>;
				};

				current_group_6 {
					cable_number = <0xa 0xc 0xe 0xf 0x1b>;
					charging_current = <0x4b0>;
					input_current = <0x384>;
				};

				current_group_7 {
					cable_number = <0xd>;
					charging_current = <0x4b0>;
					input_current = <0x2bc>;
				};

				current_group_8 {
					cable_number = <0x18>;
					charging_current = <0x1c2>;
					input_current = <0x3e8>;
				};

				current_group_9 {
					cable_number = <0x1a>;
					charging_current = <0x708>;
					input_current = <0x7d0>;
				};
			};

			s2mu005-charger {
				battery,chg_gpio_en = <0x0>;
				battery,chg_gpio_status = <0x0>;
				battery,chg_polarity_en = <0x0>;
				battery,chg_polarity_status = <0x0>;
				battery,is_1MHz_switching = <0x1>;
				compatible = "samsung,s2mu005-charger";
				status = "disable";
			};
		};
	};

	fragment@lcd {
		target-path = [2f 00];

		__overlay__ {

			nt36525b {
				lcd_params-id = <0x8aa240>;
				lcm_params-dsi-cont_clock = <0x1>;
				lcm_params-dsi-data_rate = <0x27f>;
				lcm_params-dsi-horizontal_backporch = <0x6b>;
				lcm_params-dsi-horizontal_frontporch = <0x7d>;
				lcm_params-dsi-horizontal_sync_active = <0x14>;
				lcm_params-dsi-lane_num = <0x4>;
				lcm_params-dsi-mode = <0x3>;
				lcm_params-dsi-packet_size = <0x100>;
				lcm_params-dsi-ps = <0x2>;
				lcm_params-dsi-ssc_disable = <0x1>;
				lcm_params-dsi-vertical_backporch = <0xe8>;
				lcm_params-dsi-vertical_frontporch = <0x12>;
				lcm_params-dsi-vertical_sync_active = <0x2>;
				lcm_params-physical_height = <0x79>;
				lcm_params-physical_width = <0x3b>;
				lcm_params-resolution = <0x2d0 0x5c8>;
				lcm_params-types = <0x2>;
				phandle = <0x3c>;
				smcdsd_board = <0x3f>;
			};

			panel {
				compatible = "samsung,mtk-dsi-panel";
				smcdsd_panel = <0x3b 0x3c>;
			};

			smcdsd_board_nt36525b {
				compatible = "simple-bus";
				gpio_con = <0xffffffff 0x1 0x0>;
				gpio_lcd_blen = <0xffffffff 0x1a 0x0>;
				gpio_lcd_en_1p8 = <0xffffffff 0x2 0x0>;
				gpio_lcd_rst = <0xffffffff 0x53 0x0>;
				phandle = <0x3f>;
				pinctrl-0 = <0x3d>;
				pinctrl-1 = <0x3e>;
				pinctrl-names = "off", "on";

				panel_power_disable {
					type = "delay,usleep", "3000", "gpio,low", "gpio_lcd_blen", "delay,usleep", "5000", "gpio,low", "gpio_lcd_en_1p8", "delay,usleep", "5000", "pinctrl", "off";
				};

				panel_power_enable {
					type = "pinctrl", "on", "gpio,high", "gpio_lcd_en_1p8", "delay,usleep", "2000", "gpio,high", "gpio_lcd_blen", "delay,usleep", "2000";
				};

				panel_reset_disable {
					type = "gpio,low", "gpio_lcd_rst", "delay,usleep", "5000";
				};

				panel_reset_enable {
					type = "delay,msleep", "10", "gpio,high", "gpio_lcd_rst", "delay,msleep", "10", "gpio,low", "gpio_lcd_rst", "delay,usleep", "3000", "gpio,high", "gpio_lcd_rst", "delay,msleep", "10";
				};
			};

			smcdsd_board_td4150 {
				compatible = "simple-bus";
				gpio_con = <0xffffffff 0x1 0x0>;
				gpio_lcd_blen = <0xffffffff 0x1a 0x0>;
				gpio_lcd_en_1p8 = <0xffffffff 0x2 0x0>;
				gpio_lcd_rst = <0xffffffff 0x53 0x0>;
				phandle = <0x40>;
				pinctrl-0 = <0x3d>;
				pinctrl-1 = <0x3e>;
				pinctrl-names = "off", "on";

				panel_power_disable {
					type = "delay,usleep", "3000", "gpio,low", "gpio_lcd_blen", "delay,usleep", "5000", "gpio,low", "gpio_lcd_en_1p8", "delay,usleep", "5000", "pinctrl", "off";
				};

				panel_power_enable {
					type = "pinctrl", "on", "gpio,high", "gpio_lcd_en_1p8", "delay,usleep", "2000", "gpio,high", "gpio_lcd_blen", "delay,usleep", "2000";
				};

				panel_reset_disable {
					type = "gpio,low", "gpio_lcd_rst", "delay,usleep", "5000";
				};

				panel_reset_enable {
					type = "delay,usleep", "1000", "gpio,high", "gpio_lcd_rst", "delay,usleep", "1000", "gpio,low", "gpio_lcd_rst", "delay,usleep", "1000", "gpio,high", "gpio_lcd_rst", "delay,msleep", "25";
				};
			};

			td4150 {
				lcd_params-id = <0x8ad221>;
				lcm_params-dsi-cont_clock = <0x1>;
				lcm_params-dsi-data_rate = <0x27f>;
				lcm_params-dsi-horizontal_backporch = <0x50>;
				lcm_params-dsi-horizontal_frontporch = <0xcc>;
				lcm_params-dsi-horizontal_sync_active = <0x2>;
				lcm_params-dsi-lane_num = <0x4>;
				lcm_params-dsi-mode = <0x3>;
				lcm_params-dsi-packet_size = <0x100>;
				lcm_params-dsi-ps = <0x2>;
				lcm_params-dsi-ssc_disable = <0x1>;
				lcm_params-dsi-vertical_backporch = <0xc>;
				lcm_params-dsi-vertical_frontporch = <0xbb>;
				lcm_params-dsi-vertical_sync_active = <0x2>;
				lcm_params-physical_height = <0x79>;
				lcm_params-physical_width = <0x3b>;
				lcm_params-resolution = <0x2d0 0x5c8>;
				lcm_params-types = <0x2>;
				phandle = <0x3b>;
				smcdsd_board = <0x40>;
			};
		};
	};

	fragment@model {
		target-path = [2f 00];

		__overlay__ {

			aliases {
				i2c23 = "/i2c@23";
			};

			firmware {

				android {
					compatible = "android,firmware";

					fstab {
						compatible = "android,fstab";
						status = "disabled";
					};

					vbmeta {
						compatible = "android,vbmeta";
						parts = "vbmeta,boot,system,vendor,product,odm,prism,optics,recovery";
					};
				};
			};

			i2c@23 {
				#address-cells = <0x1>;
				#size-cells = <0x0>;
				cell-index = <0x17>;
				compatible = "i2c-gpio";
				gpios = <0xffffffff 0x1e 0x0 0xffffffff 0x1c 0x0>;
				i2c-gpio,delay-us = <0x2>;
				phandle = <0x50>;
				pinctrl-0 = <0x2d 0x2e>;
				pinctrl-names = "default";
				status = "okay";

				lis2ds@1D {
					compatible = "st,lis2ds";
					interrupt-parent = <0xffffffff>;
					interrupts = <0x0 0x8 0x1>;
					pinctrl-0 = <0x2f>;
					pinctrl-names = "default";
					reg = <0x1d>;
					st,irq_gpio = <0xffffffff 0x8 0x0>;
					st,orientation = <0x1 0x2 0x1 0x0 0x1 0x1 0x1 0x1 0x0>;
					st,vdd_ldo_pin = <0xffffffff 0x60 0x0>;
				};
			};

			muic {
				dcd_timeout;
				new_factory;
			};

			sec_thermistor@0 {
				adc_array = <0x6a 0x7b 0xac 0xcc 0xf0 0x125 0x162 0x1aa 0x1ff 0x241 0x272 0x2f2 0x34a 0x3b2 0x462 0x53a 0x63c 0x755 0x7de 0x89d 0x964 0x9f0 0xb15 0xc67 0xd85>;
				adc_channel = <0x0>;
				compatible = "samsung,sec-thermistor";
				id = <0x0>;
				status = "okay";
				temp_array = <0x352 0x320 0x2bc 0x28a 0x258 0x226 0x1f4 0x1c2 0x190 0x172 0x15e 0x12c 0x10e 0xfa 0xc8 0x96 0x64 0x32 0x1e 0x0 0xffffffe2 0xffffffce 0xffffff9c 0xffffff6a 0xffffff38>;
				thermistor_name = "sec-ap-thermistor";
			};

			sec_thermistor@1 {
				adc_array = <0x7e 0xa0 0xc1 0xdd 0x110 0x130 0x182 0x1c7 0x21e 0x263 0x299 0x311 0x35f 0x3b9 0x471 0x550 0x65d 0x764 0x80a 0x856 0x99b 0x9d0 0xa76 0xc73 0xd0b>;
				adc_channel = <0xc>;
				compatible = "samsung,sec-thermistor";
				id = <0x1>;
				status = "okay";
				temp_array = <0x352 0x320 0x2bc 0x28a 0x258 0x226 0x1f4 0x1c2 0x190 0x172 0x15e 0x12c 0x10e 0xfa 0xc8 0x96 0x64 0x32 0x1e 0x0 0xffffffe2 0xffffffce 0xffffff9c 0xffffff6a 0xffffff38>;
				thermistor_name = "sec-pa-thermistor";
			};

			usb_notifier {
				compatible = "samsung,usb-notifier";
			};
		};
	};
};
